/dts-v1/;

/ {
    model = "MT6761";
    compatible = "mediatek,MT6761";
    interrupt-parent = <0x1>;
    #address-cells = <0x2>;
    #size-cells = <0x2>;
    chosen {
        bootargs = "console=tty0 console=ttyS0,921600n1 vmalloc=496M slub_max_order=0 slub_debug=OFZPU page_owner=on androidboot.hardware=mt6761 maxcpus=8 firmware_class.path=/vendor/firmware loop.max_part=7";
        linux,phandle = <0x46>;
        phandle = <0x46>;
    };
    cpus {
        #address-cells = <0x1>;
        #size-cells = <0x0>;
        cpu@000 {
            device_type = "cpu";
            compatible = "arm,cortex-a53";
            reg = <0x0>;
            enable-method = "psci";
            clock-frequency = <0x8b799100>;
            cpu-idle-states = <0x2 0x3 0x4 0x5 0x6 0x7 0x8>;
            linux,phandle = <0x9>;
            phandle = <0x9>;
        };
        cpu@001 {
            device_type = "cpu";
            compatible = "arm,cortex-a53";
            reg = <0x1>;
            enable-method = "psci";
            clock-frequency = <0x8b799100>;
            cpu-idle-states = <0x2 0x3 0x4 0x5 0x6 0x7 0x8>;
            linux,phandle = <0xa>;
            phandle = <0xa>;
        };
        cpu@002 {
            device_type = "cpu";
            compatible = "arm,cortex-a53";
            reg = <0x2>;
            enable-method = "psci";
            clock-frequency = <0x8b799100>;
            cpu-idle-states = <0x2 0x3 0x4 0x5 0x6 0x7 0x8>;
            linux,phandle = <0xb>;
            phandle = <0xb>;
        };
        cpu@003 {
            device_type = "cpu";
            compatible = "arm,cortex-a53";
            reg = <0x3>;
            enable-method = "psci";
            clock-frequency = <0x8b799100>;
            cpu-idle-states = <0x2 0x3 0x4 0x5 0x6 0x7 0x8>;
            linux,phandle = <0xc>;
            phandle = <0xc>;
        };
        cpu-map {
            cluster0 {
                core0 {
                    cpu = <0x9>;
                };
                core1 {
                    cpu = <0xa>;
                };
                core2 {
                    cpu = <0xb>;
                };
                core3 {
                    cpu = <0xc>;
                };
            };
        };
        idle-states {
            entry-method = "arm,psci";
            standby {
                compatible = "arm,idle-state";
                arm,psci-suspend-param = <0x1>;
                entry-latency-us = <0x258>;
                exit-latency-us = <0x258>;
                min-residency-us = <0x4b0>;
                linux,phandle = <0x2>;
                phandle = <0x2>;
            };
            mcdi-cpu {
                compatible = "arm,idle-state";
                arm,psci-suspend-param = <0x10001>;
                entry-latency-us = <0x258>;
                exit-latency-us = <0x258>;
                min-residency-us = <0x4b0>;
                linux,phandle = <0x3>;
                phandle = <0x3>;
            };
            mcdi-cluster {
                compatible = "arm,idle-state";
                arm,psci-suspend-param = <0x1010001>;
                entry-latency-us = <0x258>;
                exit-latency-us = <0x258>;
                min-residency-us = <0x4b0>;
                linux,phandle = <0x4>;
                phandle = <0x4>;
            };
            sodi {
                compatible = "arm,idle-state";
                arm,psci-suspend-param = <0x1010002>;
                entry-latency-us = <0x320>;
                exit-latency-us = <0x3e8>;
                min-residency-us = <0x7d0>;
                linux,phandle = <0x5>;
                phandle = <0x5>;
            };
            sodi3 {
                compatible = "arm,idle-state";
                arm,psci-suspend-param = <0x1010003>;
                entry-latency-us = <0x320>;
                exit-latency-us = <0x3e8>;
                min-residency-us = <0x7d0>;
                linux,phandle = <0x6>;
                phandle = <0x6>;
            };
            dpidle {
                compatible = "arm,idle-state";
                arm,psci-suspend-param = <0x1010004>;
                entry-latency-us = <0x320>;
                exit-latency-us = <0x3e8>;
                min-residency-us = <0x7d0>;
                linux,phandle = <0x7>;
                phandle = <0x7>;
            };
            suspend {
                compatible = "arm,idle-state";
                arm,psci-suspend-param = <0x1010005>;
                entry-latency-us = <0x320>;
                exit-latency-us = <0x3e8>;
                min-residency-us = <0x7d0>;
                linux,phandle = <0x8>;
                phandle = <0x8>;
            };
        };
    };
    gpio-keys {
        compatible = "gpio-keys";
        pinctrl-names = "default";
        pinctrl-0 = <0xd>;
        status = "okay";
        linux,phandle = <0x47>;
        phandle = <0x47>;
        button@0 {
            debounce_interval = <0x32>;
            wakeup-source;
            gpio-key,wakeup = <0x1>;
            gpios = <0xe 0x5c 0x1>;
            label = "playback";
            linux,input-type = <0x1>;
            linux,code = <0x1d0>;
        };
        button@1 {
            debounce_interval = <0x32>;
            wakeup-source;
            gpio-key,wakeup = <0x1>;
            gpios = <0xe 0x9 0x1>;
            label = "Button_R2";
            linux,input-type = <0x1>;
            linux,code = <0x139>;
        };
        button@2 {
            debounce_interval = <0x32>;
            wakeup-source;
            gpio-key,wakeup = <0x1>;
            gpios = <0xe 0xa 0x1>;
            label = "Button_R1";
            linux,input-type = <0x1>;
            linux,code = <0x137>;
        };
    };
    psci {
        compatible = "arm,psci-1.0";
        method = "smc";
    };
    pmu {
        compatible = "arm,cortex-a7-pmu";
        interrupt-parent = <0xf>;
        interrupts = <0x1 0x7 0x8>;
    };
    l2c_parity {
        compatible = "mediatek,l2c_parity-v1";
        interrupts = <0x0 0x0 0x4>;
    };
    memory {
        device_type = "memory";
        reg = <0x0 0x40000000 0x0 0x20000000>;
    };
    reserved-memory {
        #address-cells = <0x2>;
        #size-cells = <0x2>;
        ranges;
        ram_console-reserved-memory@47c80000 {
            compatible = "mediatek,ram_console";
            reg = <0x0 0x47c80000 0x0 0x10000>;
        };
        pstore-reserved-memory@47c90000 {
            compatible = "mediatek,pstore";
            reg = <0x0 0x47c90000 0x0 0xe0000>;
        };
        minirdump-reserved-memory@47d70000 {
            compatible = "mediatek,minirdump";
            reg = <0x0 0x47d70000 0x0 0x10000>;
        };
        reserve-memory-sspm_share {
            compatible = "mediatek,reserve-memory-sspm_share";
            no-map;
            status = "okay";
            size = <0x0 0x110000>;
            alignment = <0x0 0x10000>;
            alloc-ranges = <0x0 0x40000000 0x0 0x60000000>;
        };
        reserve-memory-scp_share {
            compatible = "mediatek,reserve-memory-scp_share";
            no-map;
            size = <0x0 0x300000>;
            alignment = <0x0 0x1000000>;
            alloc-ranges = <0x0 0x40000000 0x0 0x50000000>;
        };
        consys-reserve-memory {
            compatible = "mediatek,consys-reserve-memory";
            no-map;
            size = <0x0 0x400000>;
            alignment = <0x0 0x1000000>;
            alloc-ranges = <0x0 0x40000000 0x0 0x80000000>;
        };
        wifi-reserve-memory {
            compatible = "mediatek,wifi-reserve-memory";
            no-map;
            size = <0x0 0x300000>;
            alignment = <0x0 0x1000000>;
            alloc-ranges = <0x0 0x40000000 0x0 0x80000000>;
        };
    };
    utos {
        compatible = "microtrust,utos";
        interrupts = <0x0 0xbc 0x1 0x0 0xbd 0x1>;
    };
    utos_tester {
        compatible = "microtrust,tester-v1";
    };
    cpu_dbgapb@0d410000 {
        compatible = "mediatek,hw_dbg";
        num = <0x8>;
        reg = <0x0 0xd410000 0x0 0x1000 0x0 0xd510000 0x0 0x1000 0x0 0xd610000 0x0 0x1000 0x0 0xd710000 0x0 0x1000 0x0 0xd810000 0x0 0x1000 0x0 0xd910000 0x0 0x1000 0x0 0xda10000 0x0 0x1000 0x0 0xdb10000 0x0 0x1000>;
        linux,phandle = <0x48>;
        phandle = <0x48>;
    };
    atf_logger {
        compatible = "mediatek,atf_logger";
        interrupts = <0x0 0x4e 0x1>;
    };
    amms_control {
        compatible = "mediatek,amms";
        interrupts = <0x0 0x43 0x1>;
    };
    interrupt-controller@0c000000 {
        compatible = "arm,gic-v3";
        #interrupt-cells = <0x3>;
        #address-cells = <0x2>;
        #size-cells = <0x2>;
        #redistributor-regions = <0x1>;
        interrupt-parent = <0xf>;
        interrupt-controller;
        reg = <0x0 0xc000000 0x0 0x40000 0x0 0xc080000 0x0 0x200000 0x0 0x10200a80 0x0 0x50>;
        interrupts = <0x1 0x9 0x4>;
        linux,phandle = <0xf>;
        phandle = <0xf>;
    };
    intpol-controller@10200a80 {
        compatible = "mediatek,mt6577-sysirq";
        interrupt-controller;
        #interrupt-cells = <0x3>;
        interrupt-parent = <0xf>;
        reg = <0x0 0x10200a80 0x0 0x50>;
        linux,phandle = <0x1>;
        phandle = <0x1>;
    };
    infracfg_ao@10001000 {
        compatible = <0x6d656469 0x6174656b 0x2c696e66 0x72616366 0x675f616f 0x737973 0x636f6e00>;
        reg = <0x0 0x10001000 0x0 0x1000>;
        interrupts = <0x0 0x5b 0x1>;
        #clock-cells = <0x1>;
        linux,phandle = <0x21>;
        phandle = <0x21>;
    };
    mcdi@0010fc00 {
        compatible = "mediatek,mt6761-mcdi";
        reg = <0x0 0x10fc00 0x0 0x800>;
    };
    scpsys@10001000 {
        compatible = [ 6d 65 64 69 61 74 65 6b 2c 73 63 70 73 79 73 00 73 79 73 63 6f 6e 00 ];
        reg = <0x0 0x10001000 0x0 0x1000 0x0 0x10006000 0x0 0x1000 0x0 0x14002000 0x0 0x1000 0x0 0x1020e000 0x0 0x1000 0x0 0x18004000 0x0 0x1000>;
        #clock-cells = <0x1>;
        linux,phandle = <0x22>;
        phandle = <0x22>;
    };
    topckgen@10000000 {
        compatible = [ 6d 65 64 69 61 74 65 6b 2c 74 6f 70 63 6b 67 65 6e 00 73 79 73 63 6f 6e 00 ];
        reg = <0x0 0x10000000 0x0 0x1000>;
        #clock-cells = <0x1>;
        linux,phandle = <0x1b>;
        phandle = <0x1b>;
    };
    io_cfg_lt@10002000 {
        compatible = "mediatek,io_cfg_lt";
        reg = <0x0 0x10002000 0x0 0x200>;
    };
    syscfg_pctl_1@10002000 {
        compatible = [ 6d 65 64 69 61 74 65 6b 2c 6d 74 36 37 36 31 2d 70 63 74 6c 2d 31 2d 73 79 73 63 66 67 00 73 79 73 63 6f 6e 00 ];
        reg = <0x0 0x10002000 0x0 0x1000>;
        linux,phandle = <0x14>;
        phandle = <0x14>;
    };
    io_cfg_lm@10002200 {
        compatible = "mediatek,io_cfg_lm";
        reg = <0x0 0x10002200 0x0 0x200>;
    };
    syscfg_pctl_2@10002200 {
        compatible = [ 6d 65 64 69 61 74 65 6b 2c 6d 74 36 37 36 31 2d 70 63 74 6c 2d 32 2d 73 79 73 63 66 67 00 73 79 73 63 6f 6e 00 ];
        reg = <0x0 0x10002200 0x0 0x1000>;
        linux,phandle = <0x15>;
        phandle = <0x15>;
    };
    io_cfg_lb@10002400 {
        compatible = "mediatek,io_cfg_lb";
        reg = <0x0 0x10002400 0x0 0x200>;
    };
    syscfg_pctl_3@10002400 {
        compatible = [ 6d 65 64 69 61 74 65 6b 2c 6d 74 36 37 36 31 2d 70 63 74 6c 2d 33 2d 73 79 73 63 66 67 00 73 79 73 63 6f 6e 00 ];
        reg = <0x0 0x10002400 0x0 0x1000>;
        linux,phandle = <0x16>;
        phandle = <0x16>;
    };
    io_cfg_bl@10002600 {
        compatible = "mediatek,io_cfg_bl";
        reg = <0x0 0x10002600 0x0 0x200>;
    };
    syscfg_pctl_4@10002600 {
        compatible = [ 6d 65 64 69 61 74 65 6b 2c 6d 74 36 37 36 31 2d 70 63 74 6c 2d 34 2d 73 79 73 63 66 67 00 73 79 73 63 6f 6e 00 ];
        reg = <0x0 0x10002600 0x0 0x1000>;
        linux,phandle = <0x17>;
        phandle = <0x17>;
    };
    io_cfg_rr@10002800 {
        compatible = "mediatek,io_cfg_rr";
        reg = <0x0 0x10002800 0x0 0x200>;
    };
    syscfg_pctl_5@10002800 {
        compatible = [ 6d 65 64 69 61 74 65 6b 2c 6d 74 36 37 36 31 2d 70 63 74 6c 2d 35 2d 73 79 73 63 66 67 00 73 79 73 63 6f 6e 00 ];
        reg = <0x0 0x10002800 0x0 0x1000>;
        linux,phandle = <0x18>;
        phandle = <0x18>;
    };
    io_cfg_rb@10002a00 {
        compatible = "mediatek,io_cfg_rb";
        reg = <0x0 0x10002a00 0x0 0x200>;
    };
    syscfg_pctl_6@10002a00 {
        compatible = [ 6d 65 64 69 61 74 65 6b 2c 6d 74 36 37 36 31 2d 70 63 74 6c 2d 36 2d 73 79 73 63 66 67 00 73 79 73 63 6f 6e 00 ];
        reg = <0x0 0x10002a00 0x0 0x1000>;
        linux,phandle = <0x19>;
        phandle = <0x19>;
    };
    io_cfg_rt@10002c00 {
        compatible = "mediatek,io_cfg_rt";
        reg = <0x0 0x10002c00 0x0 0x200>;
    };
    syscfg_pctl_7@10002c00 {
        compatible = [ 6d 65 64 69 61 74 65 6b 2c 6d 74 36 37 36 31 2d 70 63 74 6c 2d 37 2d 73 79 73 63 66 67 00 73 79 73 63 6f 6e 00 ];
        reg = <0x0 0x10002c00 0x0 0x1000>;
        linux,phandle = <0x1a>;
        phandle = <0x1a>;
    };
    pericfg@10003000 {
        compatible = <0x6d656469 0x6174656b 0x2c706572 0x69636667 0x737973 0x636f6e00>;
        reg = <0x0 0x10003000 0x0 0x1000>;
        #clock-cells = <0x1>;
        linux,phandle = <0x49>;
        phandle = <0x49>;
    };
    efuse_dbg@10004000 {
        compatible = "mediatek,efuse_dbg";
        reg = <0x0 0x10004000 0x0 0x1000>;
    };
    smart_pa {
        linux,phandle = <0x4a>;
        phandle = <0x4a>;
    };
    tcpc_pd {
        linux,phandle = <0x4b>;
        phandle = <0x4b>;
    };
    md1_sim1_hot_plug_eint {
        linux,phandle = <0x4c>;
        phandle = <0x4c>;
    };
    md1_sim2_hot_plug_eint {
        linux,phandle = <0x4d>;
        phandle = <0x4d>;
    };
    gpio {
        compatible = "mediatek,gpio_usage_mapping";
        linux,phandle = <0x4e>;
        phandle = <0x4e>;
    };
    gpio@10005000 {
        compatible = "mediatek,gpio";
        reg = <0x0 0x10005000 0x0 0x1000>;
        linux,phandle = <0x4f>;
        phandle = <0x4f>;
    };
    syscfg_pctl_0@10005000 {
        compatible = [ 6d 65 64 69 61 74 65 6b 2c 6d 74 36 37 36 31 2d 70 63 74 6c 2d 30 2d 73 79 73 63 66 67 00 73 79 73 63 6f 6e 00 ];
        reg = <0x0 0x10005000 0x0 0x1000>;
        linux,phandle = <0x13>;
        phandle = <0x13>;
    };
    sleep@10006000 {
        compatible = "mediatek,sleep";
        reg = <0x0 0x10006000 0x0 0x1000>;
        interrupts = <0x0 0x7d 0x8>;
        wakeup-source = <0x10 0x0 0x4 0x11 0x1 0x20 0x12 0x3 0x2000000>;
    };
    pinctrl@1000b000 {
        compatible = "mediatek,mt6761-pinctrl";
        reg = <0x0 0x1000b000 0x0 0x1000>;
        mediatek,pctl-regmap = <0x13 0x14 0x15 0x16 0x17 0x18 0x19 0x1a>;
        pins-are-numbered;
        gpio-controller;
        #gpio-cells = <0x2>;
        interrupt-controller;
        #interrupt-cells = <0x4>;
        interrupts = <0x0 0x73 0x4>;
        linux,phandle = <0xe>;
        phandle = <0xe>;
        eint60default {
            linux,phandle = <0xd>;
            phandle = <0xd>;
            pins_cmd_dat {
                pinmux = <0x5c00 0x900 0xa00>;
                slew-rate = <0x0>;
                bias-pull-up = <0x65>;
                input-enable;
            };
        };
        msdc0@default {
            linux,phandle = <0x2f>;
            phandle = <0x2f>;
            pins_cmd {
                drive-strength = [ 03 ];
            };
            pins_dat {
                drive-strength = [ 03 ];
            };
            pins_clk {
                drive-strength = [ 03 ];
            };
            pins_rst {
                drive-strength = [ 03 ];
            };
            pins_ds {
                drive-strength = [ 03 ];
            };
        };
        msdc0@hs400 {
            linux,phandle = <0x30>;
            phandle = <0x30>;
            pins_cmd {
                drive-strength = [ 03 ];
            };
            pins_dat {
                drive-strength = [ 04 ];
            };
            pins_clk {
                drive-strength = [ 04 ];
            };
            pins_rst {
                drive-strength = [ 03 ];
            };
            pins_ds {
                drive-strength = [ 04 ];
            };
        };
        msdc0@hs200 {
            linux,phandle = <0x31>;
            phandle = <0x31>;
            pins_cmd {
                drive-strength = [ 03 ];
            };
            pins_dat {
                drive-strength = [ 04 ];
            };
            pins_clk {
                drive-strength = [ 04 ];
            };
            pins_rst {
                drive-strength = [ 03 ];
            };
            pins_ds {
                drive-strength = [ 04 ];
            };
        };
        msdc0@register_default {
            cmd_edge = [ 00 ];
            rdata_edge = [ 00 ];
            wdata_edge = [ 00 ];
            linux,phandle = <0x32>;
            phandle = <0x32>;
        };
        msdc1@default {
            linux,phandle = <0x34>;
            phandle = <0x34>;
            pins_cmd {
                drive-strength = [ 03 ];
            };
            pins_dat {
                drive-strength = [ 03 ];
            };
            pins_clk {
                drive-strength = [ 03 ];
            };
        };
        msdc1@sdr104 {
            linux,phandle = <0x35>;
            phandle = <0x35>;
            pins_cmd {
                drive-strength = [ 03 ];
            };
            pins_dat {
                drive-strength = [ 03 ];
            };
            pins_clk {
                drive-strength = [ 03 ];
            };
        };
        msdc1@sdr50 {
            linux,phandle = <0x36>;
            phandle = <0x36>;
            pins_cmd {
                drive-strength = [ 03 ];
            };
            pins_dat {
                drive-strength = [ 03 ];
            };
            pins_clk {
                drive-strength = [ 03 ];
            };
        };
        msdc1@ddr50 {
            linux,phandle = <0x37>;
            phandle = <0x37>;
            pins_cmd {
                drive-strength = [ 03 ];
            };
            pins_dat {
                drive-strength = [ 03 ];
            };
            pins_clk {
                drive-strength = [ 03 ];
            };
        };
        msdc1@register_default {
            cmd_edge = [ 00 ];
            rdata_edge = [ 00 ];
            wdata_edge = [ 00 ];
            linux,phandle = <0x38>;
            phandle = <0x38>;
        };
        msdc3@default {
            linux,phandle = <0x50>;
            phandle = <0x50>;
            pins_cmd {
                drive-strength = [ 04 ];
            };
            pins_dat {
                drive-strength = [ 04 ];
            };
            pins_clk {
                drive-strength = [ 04 ];
            };
        };
        msdc3@register_default {
            cmd_edge = [ 01 ];
            rdata_edge = [ 01 ];
            wdata_edge = [ 01 ];
            linux,phandle = <0x51>;
            phandle = <0x51>;
        };
    };
    toprgu@10007000 {
        compatible = "mediatek,toprgu";
        reg = <0x0 0x10007000 0x0 0x1000>;
        interrupts = <0x0 0x53 0x0>;
    };
    chipid@08000000 {
        compatible = "mediatek,chipid";
        reg = <0x0 0x8000000 0x0 0x4 0x0 0x8000004 0x0 0x4 0x0 0x8000008 0x0 0x4 0x0 0x800000c 0x0 0x4>;
    };
    mobicore {
        compatible = "trustonic,mobicore";
        interrupts = <0x0 0xc2 0x1>;
    };
    tkcore {
        compatible = "trustkernel,tkcore";
        interrupts = <0x0 0xc4 0x1>;
    };
    timer {
        compatible = "arm,armv8-timer";
        interrupt-parent = <0xf>;
        interrupts = <0x1 0xd 0x8 0x1 0xe 0x8 0x1 0xb 0x8 0x1 0xa 0x8>;
        clock-frequency = <0xc65d40>;
    };
    clocks {
        clk26m {
            compatible = "fixed-clock";
            #clock-cells = <0x0>;
            clock-frequency = <0x18cba80>;
            linux,phandle = <0x1d>;
            phandle = <0x1d>;
        };
        clk32k {
            compatible = "fixed-clock";
            #clock-cells = <0x0>;
            clock-frequency = <0x7d00>;
            linux,phandle = <0x1c>;
            phandle = <0x1c>;
        };
    };
    timer@10008000 {
        compatible = "mediatek,apxgpt";
        reg = <0x0 0x10008000 0x0 0x1000>;
        interrupts = <0x0 0x72 0x8>;
        clocks = <0x1b 0x87 0x1c>;
        clock-names = [ 63 6c 6b 31 33 6d 00 63 6c 6b 33 32 6b 00 ];
        linux,phandle = <0x52>;
        phandle = <0x52>;
    };
    hacc@1000a000 {
        compatible = "mediatek,hacc";
        reg = <0x0 0x1000a000 0x0 0x1000>;
        interrupts = <0x0 0x85 0x8>;
    };
    apirq@1000b000 {
        compatible = "mediatek,apirq";
        reg = <0x0 0x1000b000 0x0 0x1000>;
        interrupts = <0x0 0x73 0x4>;
    };
    apmixed@1000c000 {
        compatible = <0x6d656469 0x6174656b 0x2c61706d 0x69786564 0x737973 0x636f6e00>;
        reg = <0x0 0x1000c000 0x0 0x1000>;
        #clock-cells = <0x1>;
        linux,phandle = <0x3c>;
        phandle = <0x3c>;
    };
    fhctl@1000ce00 {
        compatible = "mediatek,fhctl";
        reg = <0x0 0x1000ce00 0x0 0x200>;
    };
    pwrap@1000d000 {
        compatible = "mediatek,pwrap";
        reg = <0x0 0x1000d000 0x0 0x1000>;
        interrupts = <0x0 0x7b 0x4>;
    };
    mt-pmic {
        compatible = "mediatek,mt_pmic";
        interrupt-controller;
        linux,phandle = <0x53>;
        phandle = <0x53>;
        mt635x-auxadc {
            compatible = "mediatek,mt635x-auxadc";
            #io-channel-cells = <0x1>;
            linux,phandle = <0x54>;
            phandle = <0x54>;
            batadc {
                channel = <0x0>;
                resistance-ratio = <0x3 0x1>;
                avg-num = <0x80>;
            };
            isense {
                channel = <0x1>;
                resistance-ratio = <0x3 0x1>;
                avg-num = <0x80>;
            };
            vcdt {
                channel = <0x2>;
            };
            bat_temp {
                channel = <0x3>;
                resistance-ratio = <0x1 0x1>;
            };
            chip_temp {
                channel = <0x5>;
            };
            vcore_temp {
                channel = <0x6>;
            };
            vproc_temp {
                channel = <0x7>;
            };
            accdet {
                channel = <0x9>;
            };
            tsx_temp {
                channel = <0xb>;
                avg-num = <0x80>;
            };
            hpofs_cal {
                channel = <0xc>;
                avg-num = <0x100>;
            };
            dcxo_temp {
                channel = <0xd>;
                avg-num = <0x10>;
            };
            vbif {
                channel = <0xe>;
                resistance-ratio = <0x1 0x1>;
            };
        };
        buck_regulators {
            buck_vs1 {
                regulator-name = "vs1";
                regulator-min-microvolt = <0x124f80>;
                regulator-max-microvolt = <0x2191c0>;
                regulator-ramp-delay = <0x30d4>;
                regulator-enable-ramp-delay = <0xdc>;
                linux,phandle = <0x55>;
                phandle = <0x55>;
            };
            buck_vmodem {
                regulator-name = "vmodem";
                regulator-min-microvolt = <0x7a120>;
                regulator-max-microvolt = <0x123716>;
                regulator-ramp-delay = <0x186a>;
                regulator-enable-ramp-delay = <0xdc>;
                linux,phandle = <0x56>;
                phandle = <0x56>;
            };
            buck_vcore {
                regulator-name = "vcore";
                regulator-min-microvolt = <0x7ea5e>;
                regulator-max-microvolt = <0x1406f4>;
                regulator-ramp-delay = <0x186a>;
                regulator-enable-ramp-delay = <0xdc>;
                linux,phandle = <0x57>;
                phandle = <0x57>;
            };
            buck_vproc {
                regulator-name = "vproc";
                regulator-min-microvolt = <0x7ea5e>;
                regulator-max-microvolt = <0x1406f4>;
                regulator-ramp-delay = <0x186a>;
                regulator-enable-ramp-delay = <0xdc>;
                linux,phandle = <0x58>;
                phandle = <0x58>;
            };
            buck_vpa {
                regulator-name = "vpa";
                regulator-min-microvolt = <0x7a120>;
                regulator-max-microvolt = <0x37b1d0>;
                regulator-ramp-delay = <0xc350>;
                regulator-enable-ramp-delay = <0xdc>;
                linux,phandle = <0x59>;
                phandle = <0x59>;
            };
        };
        ldo_regulators {
            ldo_vfe28 {
                compatible = "regulator-fixed";
                regulator-name = "vfe28";
                regulator-min-microvolt = <0x2ab980>;
                regulator-max-microvolt = <0x2ab980>;
                regulator-enable-ramp-delay = <0x108>;
                linux,phandle = <0x5a>;
                phandle = <0x5a>;
            };
            ldo_vxo22 {
                regulator-name = "vxo22";
                regulator-min-microvolt = <0x2191c0>;
                regulator-max-microvolt = <0x249f00>;
                regulator-enable-ramp-delay = <0x6e>;
                linux,phandle = <0x5b>;
                phandle = <0x5b>;
            };
            ldo_vrf18 {
                compatible = "regulator-fixed";
                regulator-name = "vrf18";
                regulator-min-microvolt = <0x1b7740>;
                regulator-max-microvolt = <0x1b7740>;
                regulator-enable-ramp-delay = <0x6e>;
                linux,phandle = <0x5c>;
                phandle = <0x5c>;
            };
            ldo_vrf12 {
                compatible = "regulator-fixed";
                regulator-name = "vrf12";
                regulator-min-microvolt = <0x124f80>;
                regulator-max-microvolt = <0x124f80>;
                regulator-enable-ramp-delay = <0x6e>;
                linux,phandle = <0x5d>;
                phandle = <0x5d>;
            };
            ldo_vefuse {
                regulator-name = "vefuse";
                regulator-min-microvolt = <0x124f80>;
                regulator-max-microvolt = <0x325aa0>;
                regulator-enable-ramp-delay = <0x108>;
                linux,phandle = <0x5e>;
                phandle = <0x5e>;
            };
            ldo_vcn33_bt {
                regulator-name = "vcn33_bt";
                regulator-min-microvolt = <0x325aa0>;
                regulator-max-microvolt = <0x3567e0>;
                regulator-enable-ramp-delay = <0x108>;
                linux,phandle = <0x5f>;
                phandle = <0x5f>;
            };
            ldo_vcn33_wifi {
                regulator-name = "vcn33_wifi";
                regulator-min-microvolt = <0x325aa0>;
                regulator-max-microvolt = <0x3567e0>;
                regulator-enable-ramp-delay = <0x108>;
                linux,phandle = <0x60>;
                phandle = <0x60>;
            };
            ldo_vcn28 {
                compatible = "regulator-fixed";
                regulator-name = "vcn28";
                regulator-min-microvolt = <0x2ab980>;
                regulator-max-microvolt = <0x2ab980>;
                regulator-enable-ramp-delay = <0x108>;
                linux,phandle = <0x61>;
                phandle = <0x61>;
            };
            ldo_vcn18 {
                compatible = "regulator-fixed";
                regulator-name = "vcn18";
                regulator-min-microvolt = <0x1b7740>;
                regulator-max-microvolt = <0x1b7740>;
                regulator-enable-ramp-delay = <0x108>;
                linux,phandle = <0x62>;
                phandle = <0x62>;
            };
            ldo_vcama {
                regulator-name = "vcama";
                regulator-min-microvolt = <0x2625a0>;
                regulator-max-microvolt = <0x2ab980>;
                regulator-enable-ramp-delay = <0x108>;
                linux,phandle = <0x63>;
                phandle = <0x63>;
            };
            ldo_vcamd {
                regulator-name = "vcamd";
                regulator-min-microvolt = <0xf4240>;
                regulator-max-microvolt = <0x1b7740>;
                regulator-enable-ramp-delay = <0x108>;
                linux,phandle = <0x64>;
                phandle = <0x64>;
            };
            ldo_vcamio {
                compatible = "regulator-fixed";
                regulator-name = "vcamio";
                regulator-min-microvolt = <0x1b7740>;
                regulator-max-microvolt = <0x1b7740>;
                regulator-enable-ramp-delay = <0x108>;
                linux,phandle = <0x65>;
                phandle = <0x65>;
            };
            ldo_vldo28 {
                regulator-name = "vldo28";
                regulator-min-microvolt = <0x2ab980>;
                regulator-max-microvolt = <0x2dc6c0>;
                regulator-enable-ramp-delay = <0x108>;
                linux,phandle = <0x66>;
                phandle = <0x66>;
            };
            ldo_vsram_others {
                regulator-name = "vsram_others";
                regulator-min-microvolt = <0x7ea5e>;
                regulator-max-microvolt = <0x1406f4>;
                regulator-ramp-delay = <0x186a>;
                regulator-enable-ramp-delay = <0x6e>;
                linux,phandle = <0x67>;
                phandle = <0x67>;
            };
            ldo_vsram_proc {
                regulator-name = "vsram_proc";
                regulator-min-microvolt = <0x7ea5e>;
                regulator-max-microvolt = <0x1406f4>;
                regulator-ramp-delay = <0x186a>;
                regulator-enable-ramp-delay = <0x6e>;
                linux,phandle = <0x68>;
                phandle = <0x68>;
            };
            ldo_vaux18 {
                compatible = "regulator-fixed";
                regulator-name = "vaux18";
                regulator-min-microvolt = <0x1b7740>;
                regulator-max-microvolt = <0x1b7740>;
                regulator-enable-ramp-delay = <0x108>;
                linux,phandle = <0x69>;
                phandle = <0x69>;
            };
            ldo_vaud28 {
                compatible = "regulator-fixed";
                regulator-name = "vaud28";
                regulator-min-microvolt = <0x2ab980>;
                regulator-max-microvolt = <0x2ab980>;
                regulator-enable-ramp-delay = <0x108>;
                linux,phandle = <0x6a>;
                phandle = <0x6a>;
            };
            ldo_vio28 {
                compatible = "regulator-fixed";
                regulator-name = "vio28";
                regulator-min-microvolt = <0x2ab980>;
                regulator-max-microvolt = <0x2ab980>;
                regulator-enable-ramp-delay = <0x108>;
                linux,phandle = <0x6b>;
                phandle = <0x6b>;
            };
            ldo_vio18 {
                compatible = "regulator-fixed";
                regulator-name = "vio18";
                regulator-min-microvolt = <0x1b7740>;
                regulator-max-microvolt = <0x1b7740>;
                regulator-enable-ramp-delay = <0x108>;
                linux,phandle = <0x6c>;
                phandle = <0x6c>;
            };
            ldo_vdram {
                regulator-name = "vdram";
                regulator-min-microvolt = <0x10c8e0>;
                regulator-max-microvolt = <0x124f80>;
                regulator-enable-ramp-delay = <0xce4>;
                linux,phandle = <0x6d>;
                phandle = <0x6d>;
            };
            ldo_vmc {
                regulator-name = "vmc";
                regulator-min-microvolt = <0x1b7740>;
                regulator-max-microvolt = <0x325aa0>;
                regulator-enable-ramp-delay = <0x2c>;
                linux,phandle = <0x3a>;
                phandle = <0x3a>;
            };
            ldo_vmch {
                regulator-name = "vmch";
                regulator-min-microvolt = <0x2c4020>;
                regulator-max-microvolt = <0x325aa0>;
                regulator-enable-ramp-delay = <0x2c>;
                linux,phandle = <0x39>;
                phandle = <0x39>;
            };
            ldo_vemc {
                regulator-name = "vemc";
                regulator-min-microvolt = <0x2c4020>;
                regulator-max-microvolt = <0x325aa0>;
                regulator-enable-ramp-delay = <0x2c>;
                linux,phandle = <0x33>;
                phandle = <0x33>;
            };
            ldo_vsim1 {
                regulator-name = "vsim1";
                regulator-min-microvolt = <0x19f0a0>;
                regulator-max-microvolt = <0x2f4d60>;
                regulator-enable-ramp-delay = <0x108>;
                linux,phandle = <0x6e>;
                phandle = <0x6e>;
            };
            ldo_vsim2 {
                regulator-name = "vsim2";
                regulator-min-microvolt = <0x19f0a0>;
                regulator-max-microvolt = <0x2f4d60>;
                regulator-enable-ramp-delay = <0x108>;
                linux,phandle = <0x6f>;
                phandle = <0x6f>;
            };
            ldo_vibr {
                regulator-name = "vibr";
                regulator-min-microvolt = <0x124f80>;
                regulator-max-microvolt = <0x325aa0>;
                regulator-enable-ramp-delay = <0x2c>;
                linux,phandle = <0x70>;
                phandle = <0x70>;
            };
            ldo_vusb33 {
                regulator-name = "vusb33";
                regulator-min-microvolt = <0x2dc6c0>;
                regulator-max-microvolt = <0x2f4d60>;
                regulator-enable-ramp-delay = <0x108>;
                linux,phandle = <0x71>;
                phandle = <0x71>;
            };
            aw87329_pa@ {
                compatible = "awinic,aw87329_pa";
                linux,phandle = <0x72>;
                phandle = <0x72>;
            };
        };
    };
    scp@10500000 {
        compatible = "mediatek,scp";
        status = "okay";
        reg = <0x0 0x10500000 0x0 0x40000 0x0 0x105c0000 0x0 0x3000 0x0 0x105c4000 0x0 0x1000 0x0 0x105d4000 0x0 0x6000>;
        interrupts = <0x0 0x88 0x4>;
        core_1 = "enable";
        scp_sramSize = <0x40000>;
    };
    scp_dvfs {
        compatible = "mediatek,scp_dvfs";
        clocks = <0x1b 0x6c 0x1d 0x1b 0x10 0x1b 0x1d 0x1b 0x4 0x1b 0x1a 0x1b 0x8 0x1b 0x1c>;
        clock-names = [ 63 6c 6b 5f 6d 75 78 00 63 6c 6b 5f 70 6c 6c 5f 30 00 63 6c 6b 5f 70 6c 6c 5f 31 00 63 6c 6b 5f 70 6c 6c 5f 32 00 63 6c 6b 5f 70 6c 6c 5f 33 00 63 6c 6b 5f 70 6c 6c 5f 34 00 63 6c 6b 5f 70 6c 6c 5f 35 00 63 6c 6b 5f 70 6c 6c 5f 36 00 ];
    };
    sleep_reg_md@1000f000 {
        compatible = "mediatek,sleep_reg_md";
        reg = <0x0 0x1000f000 0x0 0x1000>;
    };
    kp@10010000 {
        compatible = "mediatek,kp";
        reg = <0x0 0x10010000 0x0 0x1000>;
        interrupts = <0x0 0x7c 0x2>;
        linux,phandle = <0x10>;
        phandle = <0x10>;
    };
    mrdump_ext_rst {
        compatible = "mediatek, mrdump_ext_rst-eint";
        source = "EINT";
        mode = "IRQ";
        status = "okay";
        linux,phandle = <0x73>;
        phandle = <0x73>;
    };
    touch {
        compatible = "mediatek,touch";
        linux,phandle = <0x74>;
        phandle = <0x74>;
    };
    accdet {
        compatible = "mediatek,pmic-accdet";
        linux,phandle = <0x75>;
        phandle = <0x75>;
    };
    mt6357_gauge {
        compatible = "mediatek,mt6357_gauge";
        gauge_name = "gauge";
        alias_name = "mt6357";
    };
    gauge_timer {
        compatible = "mediatek,gauge_timer_service";
    };
    battery {
        compatible = "mediatek,bat_gm30";
        DIFFERENCE_FULLOCV_ITH = <0xc8>;
        SHUTDOWN_1_TIME = <0x3c>;
        KEEP_100_PERCENT = <0x3>;
        R_FG_VALUE = <0xa>;
        EMBEDDED_SEL = <0x0>;
        PMIC_SHUTDOWN_CURRENT = <0x14>;
        FG_METER_RESISTANCE = <0x4b>;
        CAR_TUNE_VALUE = <0x64>;
        PMIC_MIN_VOL = <0x82dc>;
        POWERON_SYSTEM_IBOOT = <0x1f4>;
        SHUTDOWN_GAUGE0_VOLTAGE = <0x84d0>;
        TEMPERATURE_T0 = <0x19>;
        TEMPERATURE_T1 = <0xa>;
        TEMPERATURE_T2 = <0x0>;
        TEMPERATURE_T3 = <0xfffffff6>;
        g_FG_PSEUDO100_T0 = <0x64>;
        g_FG_PSEUDO100_T1 = <0x64>;
        g_FG_PSEUDO100_T2 = <0x64>;
        g_FG_PSEUDO100_T3 = <0x64>;
        Q_MAX_SYS_VOLTAGE_BAT0 = <0xd16>;
        Q_MAX_SYS_VOLTAGE_BAT1 = <0xd16>;
        Q_MAX_SYS_VOLTAGE_BAT2 = <0xd16>;
        Q_MAX_SYS_VOLTAGE_BAT3 = <0xd16>;
        battery0_profile_t0_num = <0x64>;
        battery0_profile_t0 = <0x0 0xaa6e 0x528 0xe9 0xa9da 0x52f 0x1d3 0xa952 0x531 0x2bc 0xa8cd 0x529 0x3a5 0xa84a 0x51d 0x48f 0xa7ce 0x52e 0x578 0xa751 0x522 0x661 0xa6d5 0x51a 0x74b 0xa65b 0x51f 0x834 0xa5e6 0x531 0x91d 0xa56a 0x531 0xa07 0xa4f3 0x531 0xaf0 0xa47b 0x529 0xbd9 0xa3ff 0x51d 0xcc3 0xa38b 0x52e 0xdac 0xa316 0x531 0xe95 0xa2a1 0x531 0xf7f 0xa22f 0x536 0x1068 0xa1c2 0x547 0x1151 0xa14d 0x547 0x123b 0xa0de 0x547 0x1324 0xa071 0x54f 0x140d 0xa004 0x55e 0x14f7 0x9f98 0x55e 0x15e0 0x9f2b 0x55e 0x16c9 0x9ec2 0x55e 0x17b3 0x9e5f 0x568 0x189c 0x9e02 0x58b 0x1985 0x9d95 0x579 0x1a6f 0x9d2e 0x581 0x1b58 0x9ccc 0x58b 0x1c41 0x9c70 0x58d 0x1d2b 0x9c1a 0x59f 0x1e14 0x9bc5 0x5b0 0x1efd 0x9b6f 0x5c2 0x1fe7 0x9b1c 0x5d3 0x20d0 0x9ace 0x5e5 0x21b9 0x9a78 0x5f7 0x22a3 0x9a28 0x608 0x238c 0x99d7 0x61a 0x2475 0x9981 0x626 0x255f 0x9923 0x615 0x2648 0x98ab 0x5d6 0x2731 0x9826 0x57c 0x281b 0x97a7 0x52c 0x2904 0x974a 0x51a 0x29ed 0x96fc 0x509 0x2ad7 0x96ba 0x504 0x2bc0 0x967f 0x504 0x2ca9 0x9648 0x504 0x2d93 0x9612 0x504 0x2e7c 0x95db 0x504 0x2f65 0x95a9 0x50e 0x304f 0x957b 0x51a 0x3138 0x954c 0x51a 0x3221 0x9525 0x51a 0x330b 0x94fe 0x527 0x33f4 0x94d7 0x531 0x34dd 0x94b0 0x531 0x35c7 0x948a 0x531 0x36b0 0x9469 0x540 0x3799 0x944a 0x551 0x3883 0x942b 0x55e 0x396c 0x940c 0x55e 0x3a55 0x93f5 0x56f 0x3b3f 0x93d8 0x574 0x3c28 0x93bc 0x57c 0x3d11 0x93a4 0x58b 0x3dfb 0x9384 0x58b 0x3ee4 0x9351 0x55e 0x3fcd 0x930e 0x529 0x40b7 0x92c9 0x509 0x41a0 0x929a 0x51a 0x4289 0x9273 0x51a 0x4373 0x924c 0x51a 0x445c 0x9222 0x513 0x4545 0x91f4 0x504 0x462f 0x91ce 0x504 0x4718 0x91b4 0x522 0x4801 0x9194 0x531 0x48eb 0x916b 0x536 0x49d4 0x913c 0x547 0x4abd 0x90f6 0x536 0x4ba7 0x90bb 0x53d 0x4c90 0x907e 0x540 0x4d79 0x9037 0x52e 0x4e63 0x8fe9 0x51d 0x4f4c 0x8fca 0x529 0x5035 0x8fbc 0x545 0x511f 0x8fb2 0x568 0x5208 0x8fa2 0x58b 0x52f1 0x8f92 0x5d1 0x53db 0x8f46 0x5fe 0x54c4 0x8e6f 0x5fc 0x55ad 0x8ce6 0x5d8 0x5697 0x8ab6 0x61f 0x5780 0x87a3 0x6bf 0x5869 0x82b3 0x926 0x5953 0x7bde 0xeb9 0x5a3c 0x799a 0xa08>;
        battery0_profile_t1_num = <0x64>;
        battery0_profile_t1 = <0x0 0xab4a 0x7bc 0xe9 0xaa97 0x7be 0x1d3 0xa9fa 0x7b1 0x2bc 0xa96d 0x7a7 0x3a5 0xa8e9 0x7a7 0x48f 0xa865 0x7a7 0x578 0xa7e1 0x798 0x661 0xa765 0x79b 0x74b 0xa6ee 0x7a2 0x834 0xa672 0x791 0x91d 0xa5f6 0x77f 0xa07 0xa57f 0x787 0xaf0 0xa50a 0x791 0xbd9 0xa494 0x78e 0xcc3 0xa418 0x77d 0xdac 0xa3a9 0x789 0xe95 0xa337 0x791 0xf7f 0xa2c3 0x791 0x1068 0xa24e 0x791 0x1151 0xa1e1 0x791 0x123b 0xa16f 0x79d 0x1324 0xa0fd 0x7a7 0x140d 0xa08f 0x7a5 0x14f7 0xa01b 0x793 0x15e0 0x9fb3 0x7a0 0x16c9 0x9f5c 0x7c5 0x17b3 0x9f12 0x804 0x189c 0x9ed4 0x85c 0x1985 0x9e5f 0x84a 0x1a6f 0x9dc4 0x813 0x1b58 0x9d1c 0x7dc 0x1c41 0x9c80 0x7be 0x1d2b 0x9c14 0x7be 0x1e14 0x9bc8 0x7dc 0x1efd 0x9b8f 0x81d 0x1fe7 0x9b5e 0x85c 0x20d0 0x9b28 0x85c 0x21b9 0x9ae2 0x85c 0x22a3 0x9a91 0x84f 0x238c 0x9a3b 0x845 0x2475 0x99e5 0x848 0x255f 0x9987 0x859 0x2648 0x991d 0x83e 0x2731 0x98a7 0x7fd 0x281b 0x982d 0x7a5 0x2904 0x97b8 0x74d 0x29ed 0x9762 0x72a 0x2ad7 0x9712 0x714 0x2bc0 0x96cb 0x702 0x2ca9 0x968e 0x6ee 0x2d93 0x9658 0x6cb 0x2e7c 0x9621 0x6c6 0x2f65 0x95eb 0x6bc 0x304f 0x95b7 0x6ba 0x3138 0x9588 0x6dd 0x3221 0x9559 0x6dd 0x330b 0x9530 0x6dd 0x33f4 0x9509 0x6dd 0x34dd 0x94e4 0x6df 0x35c7 0x94c4 0x6f1 0x36b0 0x949f 0x6f3 0x3799 0x947c 0x6f3 0x3883 0x945d 0x6f3 0x396c 0x943e 0x6f3 0x3a55 0x9427 0x705 0x3b3f 0x940a 0x70a 0x3c28 0x93ee 0x70a 0x3d11 0x93d6 0x70a 0x3dfb 0x93b6 0x70a 0x3ee4 0x939e 0x70a 0x3fcd 0x9382 0x700 0x40b7 0x9363 0x6f3 0x41a0 0x9344 0x6f3 0x4289 0x931d 0x6e2 0x4373 0x92fc 0x6dd 0x445c 0x92d9 0x6e4 0x4545 0x92b1 0x6f1 0x462f 0x9283 0x6df 0x4718 0x9261 0x6fb 0x4801 0x9242 0x71e 0x48eb 0x9221 0x741 0x49d4 0x91fa 0x764 0x4abd 0x91bc 0x764 0x4ba7 0x917e 0x77d 0x4c90 0x913f 0x798 0x4d79 0x9100 0x7af 0x4e63 0x90ba 0x7e4 0x4f4c 0x906d 0x7fa 0x5035 0x903f 0x820 0x511f 0x902a 0x854 0x5208 0x901a 0x889 0x52f1 0x9012 0x8f2 0x53db 0x8ffa 0x999 0x54c4 0x8fb3 0xa53 0x55ad 0x8f0c 0xae9 0x5697 0x8d68 0xae9 0x5780 0x8b10 0xbd9 0x5869 0x87c0 0xd87 0x5953 0x82cc 0x10b8 0x5a3c 0x7abc 0xc95>;
        battery0_profile_t2_num = <0x64>;
        battery0_profile_t2 = <0x0 0xab18 0x3304 0xe9 0xaa17 0x3306 0x1d3 0xa932 0x32af 0x2bc 0xa869 0x3235 0x3a5 0xa7b9 0x31b3 0x48f 0xa715 0x3104 0x578 0xa679 0x3054 0x661 0xa5e2 0x2faf 0x74b 0xa552 0x2f17 0x834 0xa4ce 0x2e8a 0x91d 0xa44a 0x2dfe 0xa07 0xa3d1 0x2d7f 0xaf0 0xa35c 0x2cfd 0xbd9 0xa2e7 0x2c70 0xcc3 0xa273 0x2be4 0xdac 0xa205 0x2b85 0xe95 0xa193 0x2b24 0xf7f 0xa123 0x2abf 0x1068 0xa0be 0x2a68 0x1151 0xa078 0x2a79 0x123b 0xa02c 0x284b 0x1324 0x9fd1 0x27cc 0x140d 0x9f60 0x2a47 0x14f7 0x9ed4 0x2a01 0x15e0 0x9e34 0x298e 0x16c9 0x9d8c 0x28ff 0x17b3 0x9cea 0x2885 0x189c 0x9c5e 0x2862 0x1985 0x9be2 0x280a 0x1a6f 0x9b76 0x27d8 0x1b58 0x9b17 0x27a6 0x1c41 0x9ac2 0x276a 0x1d2b 0x9a6c 0x276a 0x1e14 0x9a1d 0x2788 0x1efd 0x99cb 0x2783 0x1fe7 0x9973 0x274c 0x20d0 0x9916 0x26e3 0x21b9 0x98c0 0x26f4 0x22a3 0x986b 0x2706 0x238c 0x9815 0x26f9 0x2475 0x97c1 0x26c5 0x255f 0x9773 0x2690 0x2648 0x972c 0x265c 0x2731 0x96e6 0x2663 0x281b 0x96a2 0x2689 0x2904 0x9664 0x2689 0x29ed 0x9626 0x2643 0x2ad7 0x95f3 0x263b 0x2bc0 0x95bd 0x264d 0x2ca9 0x9581 0x2661 0x2d93 0x9553 0x2684 0x2e7c 0x9524 0x2698 0x2f65 0x94fa 0x26bd 0x304f 0x94d3 0x26ed 0x3138 0x94ac 0x2710 0x3221 0x9495 0x2745 0x330b 0x947d 0x2779 0x33f4 0x9466 0x27ae 0x34dd 0x9450 0x27e7 0x35c7 0x9440 0x283f 0x36b0 0x9431 0x28a5 0x3799 0x9421 0x2919 0x3883 0x9414 0x2998 0x396c 0x940c 0x2a24 0x3a55 0x93fc 0x2ab0 0x3b3f 0x93ed 0x2b56 0x3c28 0x93dd 0x2c0c 0x3d11 0x93cd 0x2ccf 0x3dfb 0x93b5 0x2da2 0x3ee4 0x93a5 0x2e83 0x3fcd 0x9391 0x2f67 0x40b7 0x9379 0x304f 0x41a0 0x9362 0x3145 0x4289 0x9343 0x3228 0x4373 0x9324 0x3319 0x445c 0x9305 0x340e 0x4545 0x92e4 0x3501 0x462f 0x92be 0x35e4 0x4718 0x9290 0x36b9 0x4801 0x9261 0x378b 0x48eb 0x9230 0x3858 0x49d4 0x91fa 0x3919 0x4abd 0x91c4 0x39eb 0x4ba7 0x9182 0x3aa5 0x4c90 0x913c 0x3b5b 0x4d79 0x90f7 0x3c21 0x4e63 0x90b9 0x3d05 0x4f4c 0x9086 0x3d70 0x5035 0x9060 0x3d3b 0x511f 0x9045 0x3cff 0x5208 0x902f 0x3ccd 0x52f1 0x900a 0x3c7b 0x53db 0x8fcb 0x3bec 0x54c4 0x8f2a 0x3a81 0x55ad 0x8ea8 0x395d 0x5697 0x8ea8 0x395d 0x5780 0x8ea8 0x395d 0x5869 0x8ea8 0x395d 0x5953 0x8ea8 0x395d 0x5a3c 0x8ea8 0x395d>;
        battery0_profile_t3_num = <0x64>;
        battery0_profile_t3 = <0x0 0xab0e 0x3b1a 0xe9 0xa9ee 0x3b1e 0x1d3 0xa8f5 0x3a57 0x2bc 0xa81d 0x394e 0x3a5 0xa75c 0x3853 0x48f 0xa6aa 0x373b 0x578 0xa60b 0x3632 0x661 0xa56f 0x3521 0x74b 0xa4da 0x3422 0x834 0xa456 0x3361 0x91d 0xa3d2 0x32b2 0xa07 0xa353 0x320f 0xaf0 0xa2d7 0x319f 0xbd9 0xa25b 0x315b 0xcc3 0xa1e7 0x30bd 0xdac 0xa172 0x303e 0xe95 0xa10b 0x2fcd 0xf7f 0xa0b2 0x2f91 0x1068 0xa064 0x2fc6 0x1151 0xa007 0x2fb4 0x123b 0x9f93 0x2f7d 0x1324 0x9f09 0x2f19 0x140d 0x9e6c 0x2e8a 0x14f7 0x9dc0 0x2ded 0x15e0 0x9d29 0x2d6d 0x16c9 0x9c9a 0x2cf3 0x17b3 0x9c17 0x2c87 0x189c 0x9baa 0x2c41 0x1985 0x9b45 0x2c1e 0x1a6f 0x9ae5 0x2bee 0x1b58 0x9a8f 0x2bd0 0x1c41 0x9a42 0x2bd3 0x1d2b 0x99fc 0x2be4 0x1e14 0x99a9 0x2bc9 0x1efd 0x9953 0x2bb0 0x1fe7 0x98fe 0x2b9e 0x20d0 0x98a8 0x2b8d 0x21b9 0x9852 0x2b58 0x22a3 0x9802 0x2b3d 0x238c 0x97b5 0x2b33 0x2475 0x9767 0x2b2e 0x255f 0x9719 0x2b0b 0x2648 0x96d9 0x2b06 0x2731 0x9696 0x2b06 0x281b 0x9654 0x2b06 0x2904 0x961e 0x2b06 0x29ed 0x95e8 0x2b17 0x2ad7 0x95b1 0x2b1c 0x2bc0 0x957b 0x2b24 0x2ca9 0x9546 0x2b38 0x2d93 0x9520 0x2b5b 0x2e7c 0x94f9 0x2b6f 0x2f65 0x94d2 0x2b8a 0x304f 0x94af 0x2bb2 0x3138 0x9498 0x2be7 0x3221 0x9481 0x2c1b 0x330b 0x946f 0x2c69 0x33f4 0x945c 0x2cb9 0x34dd 0x9446 0x2d04 0x35c7 0x9436 0x2d6d 0x36b0 0x9427 0x2df4 0x3799 0x941c 0x2e80 0x3883 0x9412 0x2f17 0x396c 0x9402 0x2fc6 0x3a55 0x93f2 0x3086 0x3b3f 0x93dd 0x313b 0x3c28 0x93c9 0x3200 0x3d11 0x93ba 0x32e4 0x3dfb 0x93aa 0x33c8 0x3ee4 0x9394 0x34ba 0x3fcd 0x937d 0x35b0 0x40b7 0x9365 0x36a5 0x41a0 0x934e 0x379a 0x4289 0x932f 0x387e 0x4373 0x9310 0x3955 0x445c 0x92f1 0x3a2f 0x4545 0x92d0 0x3b0e 0x462f 0x92aa 0x3bce 0x4718 0x927c 0x3c80 0x4801 0x924d 0x3d2f 0x48eb 0x921f 0x3dde 0x49d4 0x91f0 0x3e8e 0x4abd 0x91ba 0x3f4e 0x4ba7 0x917f 0x3f96 0x4c90 0x9141 0x3f37 0x4d79 0x90fe 0x3ea1 0x4e63 0x90c7 0x3e23 0x4f4c 0x9095 0x3db4 0x5035 0x9073 0x3d67 0x511f 0x9051 0x3d19 0x5208 0x9034 0x3cd9 0x52f1 0x9014 0x3c90 0x53db 0x8fe8 0x3c2d 0x54c4 0x8fe8 0x3c2d 0x55ad 0x8fe8 0x3c2d 0x5697 0x8fe8 0x3c2d 0x5780 0x8fe8 0x3c2d 0x5869 0x8fe8 0x3c2d 0x5953 0x8fe8 0x3c2d 0x5a3c 0x8fe8 0x3c2d>;
        linux,phandle = <0x76>;
        phandle = <0x76>;
    };
    topmisc@10011000 {
        compatible = "mediatek,topmisc";
        reg = <0x0 0x10011000 0x0 0x1000>;
    };
    dvfsrc@10012000 {
        compatible = "mediatek,dvfsrc";
        reg = <0x0 0x10012000 0x0 0x1000 0x0 0x110780 0x0 0x80>;
    };
    mbist_ao@10013000 {
        compatible = "mediatek,mbist_ao";
        reg = <0x0 0x10013000 0x0 0x1000>;
    };
    apcldmain_ao@10014000 {
        compatible = "mediatek,apcldmain_ao";
        reg = <0x0 0x10014000 0x0 0x400>;
    };
    apcldmaout_ao@10014400 {
        compatible = "mediatek,apcldmaout_ao";
        reg = <0x0 0x10014400 0x0 0x400>;
    };
    apcldmamisc_ao@10014800 {
        compatible = "mediatek,apcldmamisc_ao";
        reg = <0x0 0x10014800 0x0 0x400>;
    };
    apcldmamisc_ao@10014c00 {
        compatible = "mediatek,apcldmamisc_ao";
        reg = <0x0 0x10014c00 0x0 0x400>;
    };
    aes_top0@10016000 {
        compatible = "mediatek,aes_top0";
        reg = <0x0 0x10016000 0x0 0x1000>;
    };
    sys_timer@10017000 {
        compatible = "mediatek,sys_timer";
        reg = <0x0 0x10017000 0x0 0x1000>;
        reg-names = "sys_timer_base";
        interrupts = <0x0 0x8a 0x4>;
    };
    modem_temp_share@10018000 {
        compatible = "mediatek,modem_temp_share";
        reg = <0x0 0x10018000 0x0 0x1000>;
    };
    security_ao@1001a000 {
        compatible = "mediatek,security_ao";
        reg = <0x0 0x1001a000 0x0 0x1000>;
    };
    topckgen_ao@1001b000 {
        compatible = "mediatek,topckgen_ao";
        reg = <0x0 0x1001b000 0x0 0x1000>;
    };
    iocfg_0@10002000 {
        compatible = "mediatek,iocfg_0";
        reg = <0x0 0x10002000 0x0 0x200>;
    };
    iocfg_1@10002200 {
        compatible = "mediatek,iocfg_1";
        reg = <0x0 0x10002200 0x0 0x200>;
    };
    iocfg_2@10002400 {
        compatible = "mediatek,iocfg_2";
        reg = <0x0 0x10002400 0x0 0x200>;
    };
    iocfg_3@10002600 {
        compatible = "mediatek,iocfg_3";
        reg = <0x0 0x10002600 0x0 0x200>;
    };
    iocfg_4@10002800 {
        compatible = "mediatek,iocfg_4";
        reg = <0x0 0x10002800 0x0 0x200>;
    };
    iocfg_5@10002a00 {
        compatible = "mediatek,iocfg_5";
        reg = <0x0 0x10002a00 0x0 0x200>;
    };
    mdcldmain_ao@10015000 {
        compatible = "mediatek,mdcldmain_ao";
        reg = <0x0 0x10015000 0x0 0x400>;
    };
    mdcldmaout_ao@10015400 {
        compatible = "mediatek,mdcldmaout_ao";
        reg = <0x0 0x10015400 0x0 0x400>;
    };
    mdcldmamisc_ao@10015800 {
        compatible = "mediatek,mdcldmamisc_ao";
        reg = <0x0 0x10015800 0x0 0x400>;
    };
    sys_cirq@10204000 {
        compatible = "mediatek,sys_cirq";
        reg = <0x0 0x10204000 0x0 0x1000>;
        mediatek,cirq_num = <0xd1>;
        mediatek,spi_start_offset = <0x10>;
        interrupts = <0x0 0xe0 0x8>;
    };
    mcucfg@10200000 {
        compatible = "mediatek,mcucfg";
        reg = <0x0 0x10200000 0x0 0x200>;
        interrupts = <0x0 0x0 0x4>;
    };
    mcucfg@10200200 {
        compatible = "mediatek,mcucfg";
        reg = <0x0 0x10200200 0x0 0x200>;
        interrupts = <0x0 0x1 0x8>;
    };
    mcucfg@10200400 {
        compatible = "mediatek,mcucfg";
        reg = <0x0 0x10200400 0x0 0x200>;
        interrupts = <0x0 0x2 0x4>;
    };
    mcucfg@10200600 {
        compatible = "mediatek,mcucfg";
        reg = <0x0 0x10200600 0x0 0x200>;
        interrupts = <0x0 0x3 0x4>;
    };
    mcucfg@10200800 {
        compatible = "mediatek,mcucfg";
        reg = <0x0 0x10200800 0x0 0x200>;
        interrupts = <0x0 0x4 0x4>;
    };
    mcucfg@10200a00 {
        compatible = "mediatek,mcucfg";
        reg = <0x0 0x10200a00 0x0 0x300>;
        interrupts = <0x0 0x5 0x8>;
    };
    mcucfg@10200f00 {
        compatible = "mediatek,mcucfg";
        reg = <0x0 0x10200f00 0x0 0x100>;
        interrupts = <0x0 0x6 0x8>;
    };
    mcucfg@10201000 {
        compatible = "mediatek,mcucfg";
        reg = <0x0 0x10201000 0x0 0x1000>;
        interrupts = <0x0 0x7 0x8>;
    };
    mcucfg@10202000 {
        compatible = "mediatek,mcucfg";
        reg = <0x0 0x10202000 0x0 0x1000>;
        interrupts = <0x0 0x8 0x8>;
    };
    mcucfg@10203000 {
        compatible = "mediatek,mcucfg";
        reg = <0x0 0x10203000 0x0 0x1000>;
        interrupts = <0x0 0x9 0x8>;
    };
    mcucfg_mp0_counter@10200000 {
        compatible = "mediatek,mcucfg_mp0_counter";
        reg = <0x0 0x10200000 0x0 0x4000>;
    };
    m4u@10205000 {
        cell-index = <0x0>;
        compatible = "mediatek,iommu_v0";
        reg = <0x0 0x10205000 0x0 0x1000>;
        mediatek,larbs = <0x1e 0x1f 0x20>;
        interrupts = <0x0 0x9e 0x8>;
        #iommu-cells = <0x1>;
        linux,phandle = <0x45>;
        phandle = <0x45>;
    };
    devapc@10207000 {
        compatible = "mediatek,devapc";
        reg = <0x0 0x10207000 0x0 0x1000>;
        interrupts = <0x0 0x56 0x8>;
        clocks = <0x21 0x28>;
        clock-names = "devapc-infra-clock";
    };
    bus_dbg@10208000 {
        compatible = "mediatek,bus_dbg-v2";
        reg = <0x0 0x10208000 0x0 0x1000 0x0 0x10001000 0x0 0x1000>;
        mediatek,bus_dbg_con_offset = <0x2fc>;
        interrupts = <0x0 0x55 0x8>;
    };
    ap_ccif0@10209000 {
        compatible = "mediatek,ap_ccif0";
        reg = <0x0 0x10209000 0x0 0x1000>;
        interrupts = <0x0 0x5c 0x8>;
    };
    md_ccif0@1020a000 {
        compatible = "mediatek,md_ccif0";
        reg = <0x0 0x1020a000 0x0 0x1000>;
    };
    ap_ccif1@1020b000 {
        compatible = "mediatek,ap_ccif1";
        reg = <0x0 0x1020b000 0x0 0x1000>;
        interrupts = <0x0 0x5e 0x8>;
    };
    md_ccif1@1020c000 {
        compatible = "mediatek,md_ccif1";
        reg = <0x0 0x1020c000 0x0 0x1000>;
    };
    infra_mbist@1020d000 {
        compatible = "mediatek,infra_mbist";
        reg = <0x0 0x1020d000 0x0 0x1000>;
    };
    infracfg@1020e000 {
        compatible = "mediatek,infracfg";
        reg = <0x0 0x1020e000 0x0 0x1000>;
    };
    trng@1020f000 {
        compatible = "mediatek,trng";
        reg = <0x0 0x1020f000 0x0 0x1000>;
        interrupts = <0x0 0x69 0x8>;
    };
    dxcc_sec@10210000 {
        compatible = "mediatek,dxcc_sec";
        reg = <0x0 0x10210000 0x0 0x1000>;
        interrupts = <0x0 0x6a 0x4>;
    };
    mcupm_sram2@10211000 {
        compatible = "mediatek,mcupm_sram2";
        reg = <0x0 0x10211000 0x0 0x1000>;
    };
    cq_dma@10212000 {
        compatible = "mediatek,mt-cqdma-v1";
        reg = <0x0 0x10212000 0x0 0x80 0x0 0x10212080 0x0 0x80 0x0 0x10212100 0x0 0x68>;
        interrupts = <0x0 0x39 0x8 0x0 0x3a 0x8 0x0 0x3b 0x8>;
        nr_channel = <0x3>;
        keep_clock_ao = "yes";
        clocks = <0x21 0x43>;
        clock-names = "cqdma";
    };
    mcupm_sram3@10213000 {
        compatible = "mediatek,mcupm_sram3";
        reg = <0x0 0x10213000 0x0 0x1000>;
    };
    sramrom@10214000 {
        compatible = "mediatek,sramrom";
        reg = <0x0 0x10214000 0x0 0x1000>;
    };
    mcupm_reg@10216000 {
        compatible = "mediatek,mcupm_reg";
        reg = <0x0 0x10216000 0x0 0x1000>;
    };
    mcupm_sram0@10217000 {
        compatible = "mediatek,mcupm_sram0";
        reg = <0x0 0x10217000 0x0 0x1000>;
    };
    mcupm_sram1@10218000 {
        compatible = "mediatek,mcupm_sram1";
        reg = <0x0 0x10218000 0x0 0x1000>;
    };
    emi@10219000 {
        compatible = "mediatek,emi";
        reg = <0x0 0x10219000 0x0 0x1000 0x0 0x10226000 0x0 0x1000 0x0 0x1022d000 0x0 0x1000 0x0 0x10235000 0x0 0x1000>;
        interrupts = <0x0 0x58 0x8>;
    };
    apcldmain@1021b000 {
        compatible = "mediatek,apcldmain";
        reg = <0x0 0x1021b000 0x0 0x100>;
    };
    apcldmaout@1021b400 {
        compatible = "mediatek,apcldmaout";
        reg = <0x0 0x1021b400 0x0 0x100>;
    };
    apcldmamisc@1021b800 {
        compatible = "mediatek,apcldmamisc";
        reg = <0x0 0x1021b800 0x0 0x100>;
        interrupts = <0x0 0x6d 0x4>;
    };
    mdcldmain@1021c000 {
        compatible = "mediatek,mdcldmain";
        reg = <0x0 0x1021c000 0x0 0x400>;
    };
    mdcldmaout@1021c400 {
        compatible = "mediatek,mdcldmaout";
        reg = <0x0 0x1021c400 0x0 0x400>;
    };
    mdcldmamisc@1021c800 {
        compatible = "mediatek,mdcldmamisc";
        reg = <0x0 0x1021c800 0x0 0x1000>;
    };
    mdcldma@10014000 {
        compatible = "mediatek,mdcldma";
        reg = <0x0 0x10014000 0x0 0x1000 0x0 0x1021b000 0x0 0x1000 0x0 0x10209000 0x0 0x1000 0x0 0x1020a000 0x0 0x1000>;
        interrupts = <0x0 0x6d 0x4 0x0 0x5c 0x8 0x0 0x5d 0x8 0x0 0xcd 0x2>;
        mediatek,md_id = <0x0>;
        mediatek,cldma_capability = <0x6>;
        clocks = <0x22 0x0 0x21 0x32 0x21 0x29 0x21 0x2c 0x21 0x23 0x21 0x24 0x21 0x58 0x21 0x59>;
        clock-names = [ 73 63 70 2d 73 79 73 2d 6d 64 31 2d 6d 61 69 6e 00 69 6e 66 72 61 2d 63 6c 64 6d 61 2d 62 63 6c 6b 00 69 6e 66 72 61 2d 63 63 69 66 2d 61 70 00 69 6e 66 72 61 2d 63 63 69 66 2d 6d 64 00 69 6e 66 72 61 2d 63 63 69 66 31 2d 61 70 00 69 6e 66 72 61 2d 63 63 69 66 31 2d 6d 64 00 69 6e 66 72 61 2d 63 63 69 66 32 2d 61 70 00 69 6e 66 72 61 2d 63 63 69 66 32 2d 6d 64 00 ];
        linux,phandle = <0x12>;
        phandle = <0x12>;
    };
    bpi_bsi_slv0@1021e000 {
        compatible = "mediatek,bpi_bsi_slv0";
        reg = <0x0 0x1021e000 0x0 0x1000>;
    };
    bpi_bsi_slv1@1021f000 {
        compatible = "mediatek,bpi_bsi_slv1";
        reg = <0x0 0x1021f000 0x0 0x6000>;
    };
    bpi_bsi_slv2@10225000 {
        compatible = "mediatek,bpi_bsi_slv2";
        reg = <0x0 0x10225000 0x0 0x1000>;
    };
    dvfsp@10227000 {
        compatible = "mediatek,dvfsp";
        reg = <0x0 0x10227000 0x0 0x1000>;
    };
    dvfsp@00110800 {
        compatible = "mediatek,mt6761-dvfsp";
        reg = <0x0 0x110800 0x0 0x1400 0x0 0x110800 0x0 0x1400>;
    };
    dramc@1022a000 {
        compatible = "mediatek,dramc";
        reg = <0x0 0x1022a000 0x0 0x2000 0x0 0x10232000 0x0 0x2000 0x0 0x1022c000 0x0 0x1000 0x0 0x10234000 0x0 0x1000 0x0 0x10228000 0x0 0x2000 0x0 0x10230000 0x0 0x2000 0x0 0x1022e000 0x0 0x1000 0x0 0x10236000 0x0 0x1000>;
    };
    gce@10238000 {
        compatible = <0x6d656469 0x6174656b 0x2c676365 0x737973 0x636f6e00>;
        reg = <0x0 0x10238000 0x0 0x4000>;
        #clock-cells = <0x1>;
        interrupts = <0x0 0x62 0x8>;
        g3d_config_base = <0x13000000 0x0 0xffff0000>;
        mmsys_config_base = <0x14000000 0x1 0xffff0000>;
        disp_dither_base = <0x14010000 0x2 0xffff0000>;
        mm_na_base = <0x14020000 0x3 0xffff0000>;
        imgsys_base = <0x15020000 0x4 0xffff0000>;
        vdec_gcon_base = <0x18800000 0x5 0xffff0000>;
        venc_gcon_base = <0x18810000 0x6 0xffff0000>;
        conn_peri_base = <0x18820000 0x7 0xffff0000>;
        topckgen_base = <0x18830000 0x8 0xffff0000>;
        kp_base = <0x18840000 0x9 0xffff0000>;
        scp_sram_base = <0x10000000 0xa 0xffff0000>;
        infra_na3_base = <0x10010000 0xb 0xffff0000>;
        infra_na4_base = <0x10020000 0xc 0xffff0000>;
        scp_base = <0x10030000 0xd 0xffff0000>;
        mcucfg_base = <0x10040000 0xe 0xffff0000>;
        gcpu_base = <0x10050000 0xf 0xffff0000>;
        usb0_base = <0x10200000 0x10 0xffff0000>;
        usb_sif_base = <0x10280000 0x11 0xffff0000>;
        audio_base = <0x17000000 0x12 0xffff0000>;
        vdec_base = <0x17010000 0x13 0xffff0000>;
        msdc2_base = <0x17020000 0x14 0xffff0000>;
        vdec1_base = <0x17030000 0x15 0xffff0000>;
        msdc3_base = <0x18000000 0x16 0xffff0000>;
        ap_dma_base = <0x18010000 0x17 0xffff0000>;
        gce_base = <0x18020000 0x18 0xffff0000>;
        vdec2_base = <0x18040000 0x19 0xffff0000>;
        vdec3_base = <0x18050000 0x1a 0xffff0000>;
        camsys_base = <0x18080000 0x1b 0xffff0000>;
        camsys1_base = <0x180a0000 0x1c 0xffff0000>;
        camsys2_base = <0x180b0000 0x1d 0xffff0000>;
        pwm_sw_base = <0x1100e000 0x63 0xffff0000>;
        mipitx0_base = <0x11c80000 0x63 0xffff0000>;
        mdp_rdma0_sof = <0x0>;
        mdp_ccorr0_sof = <0x1>;
        mdp_rsz0_sof = <0x2>;
        mdp_rsz1_sof = <0x3>;
        mdp_wdma_sof = <0x4>;
        mdp_wrot0_sof = <0x5>;
        mdp_tdshp0_sof = <0x6>;
        disp_ovl0_sof = <0x7>;
        disp_2l_ovl0_sof = <0x8>;
        disp_rdma0_sof = <0x9>;
        disp_wdma0_sof = <0xa>;
        disp_color0_sof = <0xb>;
        disp_ccorr0_sof = <0xc>;
        disp_aal0_sof = <0xd>;
        disp_gamma0_sof = <0xe>;
        disp_dither0_sof = <0xf>;
        disp_dsi0_sof = <0x10>;
        disp_rsz0_sof = <0x11>;
        img_dl_relay_sof = <0x12>;
        disp_pwm0_sof = <0x13>;
        mdp_rdma0_frame_done = <0x14>;
        mdp_ccorr0_frame_done = <0x15>;
        mdp_rsz0_frame_done = <0x16>;
        mdp_rsz1_frame_done = <0x17>;
        mdp_wrot0_write_frame_done = <0x18>;
        mdp_wdma_frame_done = <0x19>;
        mdp_tdshp0_frame_done = <0x1a>;
        disp_ovl0_frame_done = <0x1b>;
        disp_2l_ovl0_frame_done = <0x1c>;
        disp_rsz0_frame_done = <0x1d>;
        disp_rdma0_frame_done = <0x1e>;
        disp_wdma0_frame_done = <0x1f>;
        disp_color0_frame_done = <0x20>;
        disp_ccorr0_frame_done = <0x21>;
        disp_aal0_frame_done = <0x22>;
        disp_gamma0_frame_done = <0x23>;
        disp_dither0_frame_done = <0x24>;
        disp_dsi0_frame_done = <0x25>;
        stream_done_0 = <0x82>;
        stream_done_1 = <0x83>;
        stream_done_2 = <0x84>;
        stream_done_3 = <0x85>;
        stream_done_4 = <0x86>;
        stream_done_5 = <0x87>;
        stream_done_6 = <0x88>;
        stream_done_7 = <0x89>;
        stream_done_8 = <0x8a>;
        stream_done_9 = <0x8b>;
        buf_underrun_event_0 = <0x8c>;
        dsi0_te_event = <0x8d>;
        dsi0_irq_event = <0x8e>;
        dsi0_done_event = <0x8f>;
        disp_wdma0_rst_done = <0x93>;
        mdp_wdma_rst_done = <0x94>;
        mdp_wrot0_rst_done = <0x95>;
        mdp_rdma0_rst_done = <0x97>;
        disp_ovl0_frame_rst_done_pusle = <0x98>;
        dip_cq_thread2_frame_done = <0x101>;
        dip_cq_thread1_frame_done = <0x102>;
        dip_cq_thread0_frame_done = <0x103>;
        isp_frame_done_p1_1 = <0x104>;
        isp_frame_done_p1_0 = <0x105>;
        camsv_0_pass1_done = <0x106>;
        camsv_1_pass1_done = <0x107>;
        seninf_0_fifo_full = <0x108>;
        seninf_1_fifo_full = <0x109>;
        seninf_2_fifo_full = <0x10a>;
        seninf_3_fifo_full = <0x10b>;
        seninf_4_fifo_full = <0x10c>;
        seninf_5_fifo_full = <0x10d>;
        seninf_6_fifo_full = <0x10e>;
        seninf_7_fifo_full = <0x10f>;
        venc_done = <0x121>;
        jpgenc_done = <0x122>;
        jpgdec_done = <0x123>;
        venc_mb_done = <0x124>;
        venc_128byte_cnt_done = <0x125>;
        max_prefetch_cnt = <0x1>;
        prefetch_size = <0x60>;
        sram_size_cpr_64 = <0x40>;
        mmsys_config = <0x23>;
        mdp_rdma0 = <0x24>;
        mdp_rsz0 = <0x25>;
        mdp_rsz1 = <0x26>;
        mdp_wdma0 = <0x27>;
        mdp_wrot0 = <0x28>;
        mdp_tdshp0 = <0x29>;
        mdp_color0 = <0x2a>;
        mdp_ccorr0 = <0x2b>;
        mm_mutex = <0x2c>;
        sram_share_cnt = <0x1>;
        sram_share_engine = <0xa>;
        sram_share_event = <0x2c6>;
        clocks = <0x21 0x9 0x21 0x18>;
        clock-names = [ 47 43 45 00 47 43 45 5f 54 49 4d 45 52 00 ];
        mediatek,mailbox-gce = <0x2d>;
        mboxes = <0x2d 0x0 0x0 0x4 0x2d 0x1 0x0 0x4 0x2d 0x2 0x0 0x5 0x2d 0x3 0x0 0x4 0x2d 0x4 0x0 0x4 0x2d 0x5 0x0 0x4 0x2d 0x6 0xc8 0x4 0x2d 0x7 0xffffffff 0x2 0x2d 0x8 0x0 0x1 0x2d 0x9 0x0 0x1 0x2d 0xa 0x0 0x1 0x2d 0xb 0x0 0x1 0x2d 0xc 0x0 0x1 0x2d 0xd 0x0 0x1 0x2d 0xe 0x0 0x1 0x2d 0xf 0x0 0x1>;
        linux,phandle = <0x77>;
        phandle = <0x77>;
    };
    gce_mbox@10238000 {
        compatible = "mediatek,mailbox-gce";
        reg = <0x0 0x10238000 0x0 0x4000>;
        interrupts = <0x0 0x62 0x8>;
        #mbox-cells = <0x3>;
        #gce-event-cells = <0x1>;
        #gce-subsys-cells = <0x2>;
        clocks = <0x21 0x9 0x21 0x18>;
        clock-names = [ 67 63 65 00 47 43 45 5f 54 49 4d 45 52 00 ];
        linux,phandle = <0x2d>;
        phandle = <0x2d>;
    };
    ap_ccif2@1023c000 {
        compatible = "mediatek,ap_ccif2";
        reg = <0x0 0x1023c000 0x0 0x1000>;
        interrupts = <0x0 0x57 0x8>;
    };
    md_ccif2@1023d000 {
        compatible = "mediatek,md_ccif2";
        reg = <0x0 0x1023d000 0x0 0x1000>;
    };
    ap_ccif3@1023e000 {
        compatible = "mediatek,ap_ccif3";
        reg = <0x0 0x1023e000 0x0 0x1000>;
        interrupts = <0x0 0x5a 0x8>;
    };
    md_ccif3@1023f000 {
        compatible = "mediatek,md_ccif3";
        reg = <0x0 0x1023f000 0x0 0x1000>;
    };
    sspm@10440000 {
        compatible = "mediatek,sspm";
        reg = <0x0 0x10440000 0x0 0x10000 0x0 0x10450000 0x0 0x100 0x0 0x10451000 0x0 0x8 0x0 0x10460000 0x0 0x100 0x0 0x10461000 0x0 0x8 0x0 0x10470000 0x0 0x100 0x0 0x10471000 0x0 0x8 0x0 0x10480000 0x0 0x100 0x0 0x10481000 0x0 0x8 0x0 0x10490000 0x0 0x100 0x0 0x10491000 0x0 0x8>;
        reg-names = [ 63 66 67 72 65 67 00 6d 62 6f 78 30 5f 62 61 73 65 00 6d 62 6f 78 30 5f 63 74 72 6c 00 6d 62 6f 78 31 5f 62 61 73 65 00 6d 62 6f 78 31 5f 63 74 72 6c 00 6d 62 6f 78 32 5f 62 61 73 65 00 6d 62 6f 78 32 5f 63 74 72 6c 00 6d 62 6f 78 33 5f 62 61 73 65 00 6d 62 6f 78 33 5f 63 74 72 6c 00 6d 62 6f 78 34 5f 62 61 73 65 00 6d 62 6f 78 34 5f 63 74 72 6c 00 ];
        interrupts = <0x0 0x92 0x4 0x0 0x95 0x4 0x0 0x96 0x4 0x0 0x97 0x4 0x0 0x98 0x4 0x0 0x99 0x4>;
        interrupt-names = [ 69 70 63 00 6d 62 6f 78 30 00 6d 62 6f 78 31 00 6d 62 6f 78 32 00 6d 62 6f 78 33 00 6d 62 6f 78 34 00 ];
    };
    gic500@0c000000 {
        compatible = "mediatek,gic500";
        reg = <0x0 0xc000000 0x0 0x400000>;
    };
    gic_cpu@0c400000 {
        compatible = "mediatek,gic_cpu";
        reg = <0x0 0xc400000 0x0 0x40000>;
    };
    dfd@10200b00 {
        compatible = "mediatek,dfd";
        reg = <0x0 0x10200b00 0x0 0x10000>;
        mediatek,enabled = <0x1>;
        mediatek,chain_length = <0x61a8>;
        mediatek,rg_dfd_timeout = <0xa0>;
    };
    dbg_cti@0d020000 {
        compatible = "mediatek,dbg_cti";
        reg = <0x0 0xd020000 0x0 0x10000>;
    };
    dbg_etr@0d030000 {
        compatible = "mediatek,dbg_etr";
        reg = <0x0 0xd030000 0x0 0x10000>;
    };
    dbg_funnel@0d040000 {
        compatible = "mediatek,dbg_funnel";
        reg = <0x0 0xd040000 0x0 0x10000>;
    };
    dbg_dem@0d0a0000 {
        compatible = "mediatek,dbg_dem";
        reg = <0x0 0xd0a0000 0x0 0x10000>;
        interrupts = <0x0 0x54 0x8>;
    };
    dbg_mdsys1@0d0c0000 {
        compatible = "mediatek,dbg_mdsys1";
        reg = <0x0 0xd0c0000 0x0 0x40000>;
    };
    dbg_apmcu_mp0@0d400000 {
        compatible = "mediatek,dbg_apmcu_mp0";
        reg = <0x0 0xd400000 0x0 0x1000>;
    };
    dbg_apmcu_mp0@0d410000 {
        compatible = "mediatek,dbg_apmcu_mp0";
        reg = <0x0 0xd410000 0x0 0x1000>;
    };
    dbg_apmcu_mp0@0d420000 {
        compatible = "mediatek,dbg_apmcu_mp0";
        reg = <0x0 0xd420000 0x0 0x1000>;
    };
    dbg_apmcu_mp0@0d430000 {
        compatible = "mediatek,dbg_apmcu_mp0";
        reg = <0x0 0xd430000 0x0 0x1000>;
    };
    dbg_apmcu_mp0@0d440000 {
        compatible = "mediatek,dbg_apmcu_mp0";
        reg = <0x0 0xd440000 0x0 0x1000>;
    };
    dbg_apmcu_mp0@0d510000 {
        compatible = "mediatek,dbg_apmcu_mp0";
        reg = <0x0 0xd510000 0x0 0x1000>;
    };
    dbg_apmcu_mp0@0d520000 {
        compatible = "mediatek,dbg_apmcu_mp0";
        reg = <0x0 0xd520000 0x0 0x1000>;
    };
    dbg_apmcu_mp0@0d530000 {
        compatible = "mediatek,dbg_apmcu_mp0";
        reg = <0x0 0xd530000 0x0 0x1000>;
    };
    dbg_apmcu_mp0@0d540000 {
        compatible = "mediatek,dbg_apmcu_mp0";
        reg = <0x0 0xd540000 0x0 0x1000>;
    };
    dbg_apmcu_mp0@0d610000 {
        compatible = "mediatek,dbg_apmcu_mp0";
        reg = <0x0 0xd610000 0x0 0x1000>;
    };
    dbg_apmcu_mp0@0d620000 {
        compatible = "mediatek,dbg_apmcu_mp0";
        reg = <0x0 0xd620000 0x0 0x1000>;
    };
    dbg_apmcu_mp0@0d630000 {
        compatible = "mediatek,dbg_apmcu_mp0";
        reg = <0x0 0xd630000 0x0 0x1000>;
    };
    dbg_apmcu_mp0@0d640000 {
        compatible = "mediatek,dbg_apmcu_mp0";
        reg = <0x0 0xd640000 0x0 0x1000>;
    };
    dbg_apmcu_mp0@0d710000 {
        compatible = "mediatek,dbg_apmcu_mp0";
        reg = <0x0 0xd710000 0x0 0x1000>;
    };
    dbg_apmcu_mp0@0d720000 {
        compatible = "mediatek,dbg_apmcu_mp0";
        reg = <0x0 0xd720000 0x0 0x1000>;
    };
    dbg_apmcu_mp0@0d730000 {
        compatible = "mediatek,dbg_apmcu_mp0";
        reg = <0x0 0xd730000 0x0 0x1000>;
    };
    dbg_apmcu_mp0@0d740000 {
        compatible = "mediatek,dbg_apmcu_mp0";
        reg = <0x0 0xd740000 0x0 0x1000>;
    };
    dbg_apmcu_mp1@0d800000 {
        compatible = "mediatek,dbg_apmcu_mp1";
        reg = <0x0 0xd800000 0x0 0x1000>;
    };
    dbg_apmcu_mp1@0d810000 {
        compatible = "mediatek,dbg_apmcu_mp1";
        reg = <0x0 0xd810000 0x0 0x1000>;
    };
    dbg_apmcu_mp1@0d820000 {
        compatible = "mediatek,dbg_apmcu_mp1";
        reg = <0x0 0xd820000 0x0 0x1000>;
    };
    dbg_apmcu_mp1@0d830000 {
        compatible = "mediatek,dbg_apmcu_mp1";
        reg = <0x0 0xd830000 0x0 0x1000>;
    };
    dbg_apmcu_mp1@0d840000 {
        compatible = "mediatek,dbg_apmcu_mp1";
        reg = <0x0 0xd840000 0x0 0x1000>;
    };
    dbg_apmcu_mp1@0d910000 {
        compatible = "mediatek,dbg_apmcu_mp1";
        reg = <0x0 0xd910000 0x0 0x1000>;
    };
    dbg_apmcu_mp1@0d920000 {
        compatible = "mediatek,dbg_apmcu_mp1";
        reg = <0x0 0xd920000 0x0 0x1000>;
    };
    dbg_apmcu_mp1@0d930000 {
        compatible = "mediatek,dbg_apmcu_mp1";
        reg = <0x0 0xd930000 0x0 0x1000>;
    };
    dbg_apmcu_mp1@0d940000 {
        compatible = "mediatek,dbg_apmcu_mp1";
        reg = <0x0 0xd940000 0x0 0x1000>;
    };
    dbg_apmcu_mp1@0da10000 {
        compatible = "mediatek,dbg_apmcu_mp1";
        reg = <0x0 0xda10000 0x0 0x1000>;
    };
    dbg_apmcu_mp1@0da20000 {
        compatible = "mediatek,dbg_apmcu_mp1";
        reg = <0x0 0xda20000 0x0 0x1000>;
    };
    dbg_apmcu_mp1@0da30000 {
        compatible = "mediatek,dbg_apmcu_mp1";
        reg = <0x0 0xda30000 0x0 0x1000>;
    };
    dbg_apmcu_mp1@0da40000 {
        compatible = "mediatek,dbg_apmcu_mp1";
        reg = <0x0 0xda40000 0x0 0x1000>;
    };
    dbg_apmcu_mp1@0db10000 {
        compatible = "mediatek,dbg_apmcu_mp1";
        reg = <0x0 0xdb10000 0x0 0x1000>;
    };
    dbg_apmcu_mp1@0db20000 {
        compatible = "mediatek,dbg_apmcu_mp1";
        reg = <0x0 0xdb20000 0x0 0x1000>;
    };
    dbg_apmcu_mp1@0db30000 {
        compatible = "mediatek,dbg_apmcu_mp1";
        reg = <0x0 0xdb30000 0x0 0x1000>;
    };
    dbg_apmcu_mp1@0db40000 {
        compatible = "mediatek,dbg_apmcu_mp1";
        reg = <0x0 0xdb40000 0x0 0x1000>;
    };
    ap_dma@11000000 {
        compatible = "mediatek,ap_dma";
        reg = <0x0 0x11000000 0x0 0x1000>;
        interrupts = <0x0 0x29 0x8>;
    };
    auxadc@11001000 {
        compatible = "mediatek,auxadc";
        reg = <0x0 0x11001000 0x0 0x1000>;
        interrupts = <0x0 0x14 0x2>;
        clocks = <0x21 0x21>;
        clock-names = "auxadc-main";
        linux,phandle = <0x78>;
        phandle = <0x78>;
    };
    dma-controller@11000580 {
        compatible = "mediatek,mt6577-uart-dma";
        reg = <0x0 0x11000680 0x0 0x80 0x0 0x11000700 0x0 0x80 0x0 0x11000780 0x0 0x80 0x0 0x11000800 0x0 0x80>;
        interrupts = <0x0 0x35 0x8 0x0 0x36 0x8 0x0 0x37 0x8 0x0 0x3c 0x8>;
        clocks = <0x21 0x26>;
        clock-names = "apdma";
        #dma-cells = <0x1>;
        linux,phandle = <0x2e>;
        phandle = <0x2e>;
    };
    serial@11020000 {
        compatible = [ 6d 65 64 69 61 74 65 6b 2c 6d 74 36 37 36 31 2d 75 61 72 74 00 6d 65 64 69 61 74 65 6b 2c 6d 74 36 35 37 37 2d 75 61 72 74 00 ];
        reg = <0x0 0x11002000 0x0 0x1000>;
        interrupts = <0x0 0x23 0x8>;
        clocks = <0x1d 0x21 0x16>;
        clock-names = [ 62 61 75 64 00 62 75 73 00 ];
        dmas = <0x2e 0x0 0x2e 0x1>;
        dma-names = [ 74 78 00 72 78 00 ];
        linux,phandle = <0x79>;
        phandle = <0x79>;
    };
    serial@11030000 {
        compatible = [ 6d 65 64 69 61 74 65 6b 2c 6d 74 36 37 36 31 2d 75 61 72 74 00 6d 65 64 69 61 74 65 6b 2c 6d 74 36 35 37 37 2d 75 61 72 74 00 ];
        reg = <0x0 0x11003000 0x0 0x1000>;
        interrupts = <0x0 0x24 0x8>;
        clocks = <0x1d 0x21 0x17>;
        clock-names = [ 62 61 75 64 00 62 75 73 00 ];
        linux,phandle = <0x7a>;
        phandle = <0x7a>;
    };
    pwm@11006000 {
        compatible = "mediatek,pwm";
        reg = <0x0 0x11006000 0x0 0x1000>;
        interrupts = <0x0 0x15 0x8>;
        clocks = <0x21 0x10 0x21 0x11 0x21 0x12 0x21 0x13 0x21 0x14 0x21 0x30 0x21 0xf 0x21 0x15>;
        clock-names = [ 50 57 4d 31 2d 6d 61 69 6e 00 50 57 4d 32 2d 6d 61 69 6e 00 50 57 4d 33 2d 6d 61 69 6e 00 50 57 4d 34 2d 6d 61 69 6e 00 50 57 4d 35 2d 6d 61 69 6e 00 50 57 4d 36 2d 6d 61 69 6e 00 50 57 4d 2d 48 43 4c 4b 2d 6d 61 69 6e 00 50 57 4d 2d 6d 61 69 6e 00 ];
        linux,phandle = <0x7b>;
        phandle = <0x7b>;
    };
    i2c_common {
        compatible = "mediatek,i2c_common";
        dma_support = [ 02 ];
        idvfs = [ 01 ];
        set_dt_div = [ 01 ];
        check_max_freq = [ 01 ];
        ver = [ 02 ];
        set_ltiming = [ 01 ];
        ext_time_config = [ 18 01 ];
        cnt_constraint = [ 01 ];
        linux,phandle = <0x7c>;
        phandle = <0x7c>;
    };
    i2c0@11007000 {
        compatible = "mediatek,i2c";
        id = <0x0>;
        reg = <0x0 0x11007000 0x0 0x1000 0x0 0x11000080 0x0 0x80>;
        interrupts = <0x0 0x1c 0x8>;
        clocks = <0x21 0xb 0x21 0x26>;
        clock-names = [ 6d 61 69 6e 00 64 6d 61 00 ];
        clock-div = <0x5>;
        aed = <0x1a>;
        mediatek,hs_only;
        linux,phandle = <0x7d>;
        phandle = <0x7d>;
    };
    i2c1@11008000 {
        compatible = "mediatek,i2c";
        id = <0x1>;
        reg = <0x0 0x11008000 0x0 0x1000 0x0 0x11000100 0x0 0x80>;
        interrupts = <0x0 0x1d 0x8>;
        clocks = <0x21 0xb 0x21 0x26>;
        clock-names = [ 6d 61 69 6e 00 64 6d 61 00 ];
        clock-div = <0x5>;
        aed = <0x1a>;
        mediatek,hs_only;
        linux,phandle = <0x7e>;
        phandle = <0x7e>;
    };
    i2c2@11009000 {
        compatible = "mediatek,i2c";
        id = <0x2>;
        reg = <0x0 0x11009000 0x0 0x1000 0x0 0x11000180 0x0 0x180>;
        interrupts = <0x0 0x1e 0x8>;
        clocks = <0x21 0xb 0x21 0x26>;
        clock-names = [ 6d 61 69 6e 00 64 6d 61 00 ];
        clock-div = <0x5>;
        aed = <0x1a>;
        ch_offset_default = <0x100>;
        ch_offset_ccu = <0x200>;
        mediatek,hs_only;
        linux,phandle = <0x7f>;
        phandle = <0x7f>;
    };
    i2c3@1100f000 {
        compatible = "mediatek,i2c";
        id = <0x3>;
        reg = <0x0 0x1100f000 0x0 0x1000 0x0 0x11000300 0x0 0x100>;
        interrupts = <0x0 0x1f 0x8>;
        clocks = <0x21 0xb 0x21 0x26>;
        clock-names = [ 6d 61 69 6e 00 64 6d 61 00 ];
        clock-div = <0x5>;
        aed = <0x1a>;
        ch_offset_default = <0x100>;
        mediatek,hs_only;
        linux,phandle = <0x80>;
        phandle = <0x80>;
    };
    i2c4@11011000 {
        compatible = "mediatek,i2c";
        id = <0x4>;
        reg = <0x0 0x11011000 0x0 0x1000 0x0 0x11000400 0x0 0x180>;
        interrupts = <0x0 0x20 0x8>;
        clocks = <0x21 0xb 0x21 0x26>;
        clock-names = [ 6d 61 69 6e 00 64 6d 61 00 ];
        clock-div = <0x5>;
        aed = <0x1a>;
        ch_offset_default = <0x100>;
        ch_offset_ccu = <0x200>;
        mediatek,hs_only;
        linux,phandle = <0x81>;
        phandle = <0x81>;
    };
    i2c5@11016000 {
        compatible = "mediatek,i2c";
        id = <0x5>;
        reg = <0x0 0x11016000 0x0 0x1000 0x0 0x11000580 0x0 0x80>;
        interrupts = <0x0 0x4a 0x8>;
        clocks = <0x21 0xb 0x21 0x26>;
        clock-names = [ 6d 61 69 6e 00 64 6d 61 00 ];
        clock-div = <0x5>;
        aed = <0x1a>;
        mediatek,hs_only;
        linux,phandle = <0x82>;
        phandle = <0x82>;
    };
    i2c6@1100d000 {
        compatible = "mediatek,i2c";
        id = <0x6>;
        reg = <0x0 0x1100d000 0x0 0x1000 0x0 0x11000600 0x0 0x80>;
        interrupts = <0x0 0x4b 0x8>;
        clocks = <0x21 0xb 0x21 0x26>;
        clock-names = [ 6d 61 69 6e 00 64 6d 61 00 ];
        clock-div = <0x5>;
        aed = <0x1a>;
        ch_offset_default = <0x100>;
        ch_offset_ccu = <0x200>;
        mediatek,hs_only;
        linux,phandle = <0x83>;
        phandle = <0x83>;
    };
    i2c7 {
        linux,phandle = <0x84>;
        phandle = <0x84>;
    };
    i2c8 {
        linux,phandle = <0x85>;
        phandle = <0x85>;
    };
    i2c9 {
        linux,phandle = <0x86>;
        phandle = <0x86>;
    };
    spi0@1100a000 {
        compatible = "mediatek,mt6765-spi";
        mediatek,pad-select = <0x0>;
        reg = <0x0 0x1100a000 0x0 0x1000>;
        interrupts = <0x0 0x3e 0x8>;
        clocks = <0x1b 0xd 0x1b 0x74 0x21 0x1b>;
        clock-names = [ 70 61 72 65 6e 74 2d 63 6c 6b 00 73 65 6c 2d 63 6c 6b 00 73 70 69 2d 63 6c 6b 00 ];
        linux,phandle = <0x87>;
        phandle = <0x87>;
    };
    therm_ctrl@1100b000 {
        compatible = "mediatek,therm_ctrl";
        reg = <0x0 0x1100b000 0x0 0x1000>;
        interrupts = <0x0 0x16 0x8>;
        clocks = <0x21 0xa>;
        clock-names = "therm-main";
    };
    eem_fsm@1100b000 {
        compatible = "mediatek,eem_fsm";
        reg = <0x0 0x1100b000 0x0 0x1000>;
        interrupts = <0x0 0x45 0x8>;
    };
    btif@1100c000 {
        compatible = "mediatek,btif";
        reg = <0x0 0x1100c000 0x0 0x1000 0x0 0x11000880 0x0 0x80 0x0 0x11000900 0x0 0x80>;
        interrupts = <0x0 0x38 0x8 0x0 0x4c 0x8 0x0 0x4d 0x8>;
        clocks = <0x21 0x1a 0x21 0x26>;
        clock-names = [ 62 74 69 66 63 00 61 70 64 6d 61 63 00 ];
    };
    consys@18002000 {
        compatible = "mediatek,mt6761-consys";
        #address-cells = <0x2>;
        #size-cells = <0x2>;
        reg = <0x0 0x18002000 0x0 0x1000 0x0 0x10007000 0x0 0x100 0x0 0x10001000 0x0 0x1000 0x0 0x10006000 0x0 0x1000 0x0 0x18007000 0x0 0x1000 0x0 0x180b1000 0x0 0x1000 0x0 0x180a3000 0x0 0x1000 0x0 0x180a5000 0x0 0x800 0x0 0x180c1000 0x0 0x1000 0x0 0x18004000 0x0 0x1000>;
        interrupts = <0x0 0xd3 0x8 0x0 0xd5 0x8 0x0 0xd6 0x1>;
        clocks = <0x22 0x1>;
        clock-names = "conn";
        linux,phandle = <0x11>;
        phandle = <0x11>;
    };
    wifi@18000000 {
        compatible = "mediatek,wifi";
        reg = <0x0 0x18000000 0x0 0x100000>;
        interrupts = <0x0 0xd4 0x8>;
    };
    disp_pwm@1100e000 {
        compatible = "mediatek,disp_pwm";
        reg = <0x0 0x1100e000 0x0 0x1000>;
    };
    spi1@11010000 {
        compatible = "mediatek,mt6765-spi";
        mediatek,pad-select = <0x0>;
        reg = <0x0 0x11010000 0x0 0x1000>;
        interrupts = <0x0 0x42 0x8>;
        clocks = <0x1b 0xd 0x1b 0x74 0x21 0x34>;
        clock-names = [ 70 61 72 65 6e 74 2d 63 6c 6b 00 73 65 6c 2d 63 6c 6b 00 73 70 69 2d 63 6c 6b 00 ];
        linux,phandle = <0x88>;
        phandle = <0x88>;
    };
    spi2@11012000 {
        compatible = "mediatek,mt6765-spi";
        mediatek,pad-select = <0x0>;
        reg = <0x0 0x11012000 0x0 0x1000>;
        interrupts = <0x0 0x48 0x8>;
        clocks = <0x1b 0xd 0x1b 0x74 0x21 0x37>;
        clock-names = [ 70 61 72 65 6e 74 2d 63 6c 6b 00 73 65 6c 2d 63 6c 6b 00 73 70 69 2d 63 6c 6b 00 ];
        linux,phandle = <0x89>;
        phandle = <0x89>;
    };
    spi3@11013000 {
        compatible = "mediatek,mt6765-spi";
        mediatek,pad-select = <0x0>;
        reg = <0x0 0x11013000 0x0 0x1000>;
        interrupts = <0x0 0x49 0x8>;
        clocks = <0x1b 0xd 0x1b 0x74 0x21 0x38>;
        clock-names = [ 70 61 72 65 6e 74 2d 63 6c 6b 00 73 65 6c 2d 63 6c 6b 00 73 70 69 2d 63 6c 6b 00 ];
        linux,phandle = <0x8a>;
        phandle = <0x8a>;
    };
    spi4@11014000 {
        compatible = "mediatek,mt6765-spi";
        mediatek,pad-select = <0x0>;
        reg = <0x0 0x11014000 0x0 0x1000>;
        interrupts = <0x0 0x27 0x8>;
        clocks = <0x1b 0xd 0x1b 0x74 0x21 0x41>;
        clock-names = [ 70 61 72 65 6e 74 2d 63 6c 6b 00 73 65 6c 2d 63 6c 6b 00 73 70 69 2d 63 6c 6b 00 ];
        linux,phandle = <0x8b>;
        phandle = <0x8b>;
    };
    spi5@11015000 {
        compatible = "mediatek,mt6765-spi";
        mediatek,pad-select = <0x0>;
        reg = <0x0 0x11015000 0x0 0x1000>;
        interrupts = <0x0 0x28 0x8>;
        clocks = <0x1b 0xd 0x1b 0x74 0x21 0x42>;
        clock-names = [ 70 61 72 65 6e 74 2d 63 6c 6b 00 73 65 6c 2d 63 6c 6b 00 73 70 69 2d 63 6c 6b 00 ];
        linux,phandle = <0x8c>;
        phandle = <0x8c>;
    };
    imp_iic@11017000 {
        compatible = "mediatek,imp_iic";
        reg = <0x0 0x11017000 0x0 0x1000>;
    };
    nfi@11018000 {
        compatible = "mediatek,nfi";
        reg = <0x0 0x11018000 0x0 0x1000>;
    };
    nfiecc@11019000 {
        compatible = "mediatek,nfiecc";
        reg = <0x0 0x11019000 0x0 0x1000>;
    };
    usb0@11200000 {
        compatible = "mediatek,mt6761-usb20";
        reg = <0x0 0x11200000 0x0 0x10000 0x0 0x11cc0000 0x0 0x10000>;
        interrupts = <0x0 0x11 0x8>;
        mode = <0x2>;
        multipoint = <0x1>;
        num_eps = <0x10>;
        clocks = <0x21 0x8 0x1b 0x7f 0x1b 0x23>;
        clock-names = [ 75 73 62 30 00 75 73 62 30 5f 63 6c 6b 5f 74 6f 70 5f 73 65 6c 00 75 73 62 30 5f 63 6c 6b 5f 75 6e 69 76 70 6c 6c 33 5f 64 34 00 ];
    };
    usb_sif@11210000 {
        compatible = "mediatek,usb_sif";
        reg = <0x0 0x11210000 0x0 0x1000>;
    };
    msdc@11230000 {
        compatible = "mediatek,msdc";
        reg = <0x0 0x11230000 0x0 0x10000>;
        interrupts = <0x0 0x17 0x8>;
        index = [ 00 ];
        clk_src = [ 01 ];
        bus-width = <0x8>;
        max-frequency = <0xbebc200>;
        cap-mmc-highspeed;
        mmc-ddr-1_8v;
        mmc-hs200-1_8v;
        mmc-hs400-1_8v;
        no-sd;
        no-sdio;
        non-removable;
        pinctl = <0x2f>;
        pinctl_hs400 = <0x30>;
        pinctl_hs200 = <0x31>;
        register_setting = <0x32>;
        host_function = [ 00 ];
        bootable;
        status = "okay";
        vmmc-supply = <0x33>;
        clocks = <0x21 0x4f 0x21 0x1c 0x21 0x45>;
        clock-names = [ 6d 73 64 63 30 2d 63 6c 6f 63 6b 00 6d 73 64 63 30 2d 68 63 6c 6f 63 6b 00 6d 73 64 63 30 2d 61 65 73 2d 63 6c 6f 63 6b 00 ];
        linux,phandle = <0x8d>;
        phandle = <0x8d>;
    };
    msdc@11240000 {
        compatible = "mediatek,msdc";
        reg = <0x0 0x11240000 0x0 0x10000>;
        interrupts = <0x0 0x18 0x8>;
        index = [ 01 ];
        clk_src = [ 02 ];
        bus-width = <0x4>;
        max-frequency = <0xbebc200>;
        cap-sd-highspeed;
        sd-uhs-sdr12;
        sd-uhs-sdr25;
        sd-uhs-sdr50;
        sd-uhs-sdr104;
        sd-uhs-ddr50;
        no-mmc;
        no-sdio;
        pinctl = <0x34>;
        pinctl_sdr104 = <0x35>;
        pinctl_sdr50 = <0x36>;
        pinctl_ddr50 = <0x37>;
        register_setting = <0x38>;
        host_function = [ 01 ];
        cd_level = [ 00 ];
        cd-gpios = <0xe 0x1 0x0>;
        status = "okay";
        vmmc-supply = <0x39>;
        vqmmc-supply = <0x3a>;
        clocks = <0x21 0x50 0x21 0x1d>;
        clock-names = [ 6d 73 64 63 31 2d 63 6c 6f 63 6b 00 6d 73 64 63 31 2d 68 63 6c 6f 63 6b 00 ];
        linux,phandle = <0x8e>;
        phandle = <0x8e>;
    };
    msdc@11250000 {
        compatible = "mediatek,msdc2";
        reg = <0x0 0x11250000 0x0 0x10000>;
        status = "disable";
        linux,phandle = <0x8f>;
        phandle = <0x8f>;
    };
    msdc@11260000 {
        compatible = "mediatek,msdc3";
        reg = <0x0 0x11250000 0x0 0x10000>;
        status = "disable";
        linux,phandle = <0x90>;
        phandle = <0x90>;
    };
    msdc1_ins@0 {
        compatible = "mediatek,mt6761-sdcard-ins";
        linux,phandle = <0x91>;
        phandle = <0x91>;
    };
    msdc0_top@11cd0000 {
        compatible = "mediatek,msdc0_top";
        reg = <0x0 0x11cd0000 0x0 0x1000>;
        cd-gpios = <0xe 0x2f 0x0>;
    };
    msdc1_top@11c90000 {
        compatible = "mediatek,msdc1_top";
        reg = <0x0 0x11c90000 0x0 0x1000>;
    };
    usb1p_sif@11210000 {
        compatible = "mediatek,usb1p_sif";
        reg = <0x0 0x11210000 0x0 0x10000>;
    };
    btcvsd@10001000 {
        compatible = "mediatek,audio_bt_cvsd";
        offset = <0xf00 0x800 0x140 0x144 0x148>;
        reg = <0x0 0x10001000 0x0 0x1000 0x0 0x18050000 0x0 0x1000 0x0 0x18080000 0x0 0x10000>;
        interrupts = <0x0 0xd2 0x8>;
    };
    audio@11220000 {
        compatible = [ 6d 65 64 69 61 74 65 6b 2c 61 75 64 69 6f 00 73 79 73 63 6f 6e 00 ];
        reg = <0x0 0x11220000 0x0 0x1000>;
        #clock-cells = <0x1>;
        linux,phandle = <0x3b>;
        phandle = <0x3b>;
    };
    mt_soc_dl1_pcm@11220000 {
        compatible = "mediatek,mt_soc_pcm_dl1";
        reg = <0x0 0x11220000 0x0 0x1000>;
        interrupts = <0x0 0x61 0x8>;
        clocks = <0x3b 0x0 0x3b 0x4 0x3b 0x5 0x3b 0x3 0x3b 0x1 0x3b 0x2 0x3b 0x6 0x21 0x2b 0x21 0x33 0x1b 0x78 0x1b 0x79 0x1b 0x5 0x1b 0x7a 0x1b 0x2b 0x1b 0x7b 0x1b 0x2e 0x3c 0x6 0x1d>;
        clock-names = [ 61 75 64 5f 61 66 65 5f 63 6c 6b 00 61 75 64 5f 64 61 63 5f 63 6c 6b 00 61 75 64 5f 64 61 63 5f 70 72 65 64 69 73 5f 63 6c 6b 00 61 75 64 5f 61 64 63 5f 63 6c 6b 00 61 75 64 5f 61 70 6c 6c 32 32 6d 5f 63 6c 6b 00 61 75 64 5f 61 70 6c 6c 31 5f 74 75 6e 65 72 5f 63 6c 6b 00 61 75 64 5f 74 6d 6c 5f 63 6c 6b 00 61 75 64 5f 69 6e 66 72 61 5f 63 6c 6b 00 6d 74 6b 61 69 66 5f 32 36 6d 5f 63 6c 6b 00 74 6f 70 5f 6d 75 78 5f 61 75 64 69 6f 00 74 6f 70 5f 6d 75 78 5f 61 75 64 69 6f 5f 69 6e 74 00 74 6f 70 5f 73 79 73 5f 70 6c 6c 31 5f 64 34 00 74 6f 70 5f 6d 75 78 5f 61 75 64 5f 31 00 74 6f 70 5f 61 70 6c 6c 31 5f 63 6b 00 74 6f 70 5f 6d 75 78 5f 61 75 64 5f 65 6e 67 31 00 74 6f 70 5f 61 70 6c 6c 31 5f 64 38 00 61 70 6d 69 78 65 64 5f 61 70 6c 6c 31 00 74 6f 70 5f 63 6c 6b 32 36 6d 5f 63 6c 6b 00 ];
        linux,phandle = <0x92>;
        phandle = <0x92>;
    };
    audio_sram@11221000 {
        compatible = "mediatek,audio_sram";
        reg = <0x0 0x11221000 0x0 0x9000>;
    };
    mipi_rx_ana_csi0a@11c10000 {
        compatible = [ 6d 65 64 69 61 74 65 6b 2c 6d 69 70 69 5f 72 78 5f 61 6e 61 5f 63 73 69 30 61 00 73 79 73 63 6f 6e 00 ];
        reg = <0x0 0x11c10000 0x0 0x1000>;
        #clock-cells = <0x1>;
        linux,phandle = <0x3e>;
        phandle = <0x3e>;
    };
    mipi_rx_ana_csi1@11c20000 {
        compatible = "mediatek,mipi_rx_ana_csi1";
        reg = <0x0 0x11c20000 0x0 0x10000>;
    };
    mipi_rx_ana_csi0b@11c11000 {
        compatible = [ 6d 65 64 69 61 74 65 6b 2c 6d 69 70 69 5f 72 78 5f 61 6e 61 5f 63 73 69 30 62 00 73 79 73 63 6f 6e 00 ];
        reg = <0x0 0x11c11000 0x0 0x1000>;
        #clock-cells = <0x1>;
        linux,phandle = <0x3f>;
        phandle = <0x3f>;
    };
    mipi_rx_ana_csi1a@11c12000 {
        compatible = [ 6d 65 64 69 61 74 65 6b 2c 6d 69 70 69 5f 72 78 5f 61 6e 61 5f 63 73 69 31 61 00 73 79 73 63 6f 6e 00 ];
        reg = <0x0 0x11c12000 0x0 0x1000>;
        #clock-cells = <0x1>;
        linux,phandle = <0x40>;
        phandle = <0x40>;
    };
    mipi_rx_ana_csi1b@11c13000 {
        compatible = [ 6d 65 64 69 61 74 65 6b 2c 6d 69 70 69 5f 72 78 5f 61 6e 61 5f 63 73 69 31 62 00 73 79 73 63 6f 6e 00 ];
        reg = <0x0 0x11c13000 0x0 0x1000>;
        #clock-cells = <0x1>;
        linux,phandle = <0x41>;
        phandle = <0x41>;
    };
    mipi_rx_ana_csi2a@11c14000 {
        compatible = [ 6d 65 64 69 61 74 65 6b 2c 6d 69 70 69 5f 72 78 5f 61 6e 61 5f 63 73 69 32 61 00 73 79 73 63 6f 6e 00 ];
        reg = <0x0 0x11c14000 0x0 0x1000>;
        #clock-cells = <0x1>;
        linux,phandle = <0x42>;
        phandle = <0x42>;
    };
    mipi_rx_ana_csi2b@11c15000 {
        compatible = [ 6d 65 64 69 61 74 65 6b 2c 6d 69 70 69 5f 72 78 5f 61 6e 61 5f 63 73 69 32 62 00 73 79 73 63 6f 6e 00 ];
        reg = <0x0 0x11c15000 0x0 0x1000>;
        #clock-cells = <0x1>;
        linux,phandle = <0x43>;
        phandle = <0x43>;
    };
    mipi_rx_ana_csi2@11c30000 {
        compatible = "mediatek,mipi_rx_ana_csi2";
        reg = <0x0 0x11c30000 0x0 0x10000>;
    };
    efusec@11c50000 {
        compatible = "mediatek,efusec";
        reg = <0x0 0x11c50000 0x0 0x10000>;
    };
    mipi_tx0@11c80000 {
        compatible = "mediatek,mipi_tx0";
        reg = <0x0 0x11c80000 0x0 0x10000>;
    };
    msdc1_pad_macro@11c90000 {
        compatible = "mediatek,msdc1_pad_macro";
        reg = <0x0 0x11c90000 0x0 0x10000>;
    };
    msdc0_pad_macro@11cd0000 {
        compatible = "mediatek,msdc0_pad_macro";
        reg = <0x0 0x11cd0000 0x0 0x10000>;
    };
    mfg_clark@13000000 {
        compatible = "mediatek,clark";
        reg = <0x0 0x13000000 0x0 0x80000>;
        interrupts = <0x0 0xcb 0x8>;
        interrupt-names = "RGX";
        clock-frequency = <0x21f98280>;
    };
    mfg_cfg@13ffe000 {
        compatible = [ 6d 65 64 69 61 74 65 6b 2c 6d 66 67 63 66 67 00 73 79 73 63 6f 6e 00 ];
        reg = <0x0 0x13ffe000 0x0 0x1000>;
        #clock-cells = <0x1>;
        linux,phandle = <0x93>;
        phandle = <0x93>;
    };
    gpufreq {
        compatible = "mediatek,mt6761-gpufreq";
        clocks = <0x1b 0x6d 0x1b 0x28 0x1d 0x22 0x7 0x22 0x4 0x22 0x6>;
        clock-names = <0x636c6b5f 0x6d757800 0x636c6b5f 0x6d61696e 0x5f706172 0x656e7400 0x636c6b5f 0x7375625f 0x70617265 0x6e74006d 0x74636d6f 0x735f6d66 0x675f6173 0x796e6300 0x6d74636d 0x6f735f6d 0x6667006d 0x74636d6f 0x735f6d66 0x675f636f 0x72653000>;
    };
    mmsys_config@14000000 {
        compatible = [ 6d 65 64 69 61 74 65 6b 2c 6d 6d 73 79 73 5f 63 6f 6e 66 69 67 00 73 79 73 63 6f 6e 00 ];
        reg = <0x0 0x14000000 0x0 0x1000>;
        interrupts = <0x0 0xab 0x8>;
        #clock-cells = <0x1>;
        clocks = <0x23 0x17 0x23 0x1a 0x23 0x1b>;
        clock-names = [ 43 41 4d 5f 4d 44 50 00 49 4d 47 5f 44 4c 5f 52 45 4c 41 59 00 49 4d 47 5f 44 4c 5f 41 53 59 4e 43 5f 54 4f 50 00 ];
        linux,phandle = <0x23>;
        phandle = <0x23>;
    };
    nfc {
        compatible = "mediatek,nfc-gpio-v2";
        gpio-rst = <0xac>;
        gpio-rst-std = <0xe 0xac 0x0>;
        gpio-irq = <0xa>;
        gpio-irq-std = <0xe 0xa 0x0>;
        linux,phandle = <0x94>;
        phandle = <0x94>;
    };
    irq_nfc {
        compatible = "mediatek,irq_nfc-eint";
        linux,phandle = <0x95>;
        phandle = <0x95>;
    };
    disp_mutex0@14001000 {
        compatible = "mediatek,disp_mutex0";
        reg = <0x0 0x14001000 0x0 0x1000>;
        interrupts = <0x0 0x9a 0x8>;
        linux,phandle = <0x2c>;
        phandle = <0x2c>;
    };
    smi_common@14002000 {
        compatible = "mediatek,smi_common";
        reg = <0x0 0x14002000 0x0 0x1000>;
        nr_larbs = <0x3>;
        larbs = <0x1e 0x1f 0x20>;
        mmsys_config = <0x23>;
        clocks = <0x22 0x3 0x23 0x15 0x23 0x16 0x23 0x13>;
        clock-names = [ 6d 74 63 6d 6f 73 2d 64 69 73 00 73 6d 69 2d 63 6f 6d 6d 30 00 73 6d 69 2d 63 6f 6d 6d 31 00 73 6d 69 2d 63 6f 6d 6d 6f 6e 00 ];
    };
    mmdvfs_pmqos {
        compatible = "mediatek,mmdvfs_pmqos";
        mm_step0 = <0x1b4 0x1 0x0 0x1>;
        mm_step0_ext = <0x1b4 0x2 0x6 0x10c4ec>;
        mm_step1 = <0x138 0x1 0x0 0x2>;
        mm_step1_ext = <0x138 0x2 0x6 0x10c4ec>;
        mm_step2 = <0xe3 0x1 0x0 0x3>;
        mm_step2_ext = <0xe3 0x2 0x6 0x117627>;
        vopp_steps = <0x0 0x1 0x3>;
        disp_freq = [ 6d 6d 5f 73 74 65 70 30 00 6d 6d 5f 73 74 65 70 31 00 6d 6d 5f 73 74 65 70 32 00 ];
        mdp_freq = [ 6d 6d 5f 73 74 65 70 30 00 6d 6d 5f 73 74 65 70 31 00 6d 6d 5f 73 74 65 70 32 00 ];
        cam_freq = [ 6d 6d 5f 73 74 65 70 30 00 6d 6d 5f 73 74 65 70 31 00 6d 6d 5f 73 74 65 70 32 00 ];
        img_freq = [ 6d 6d 5f 73 74 65 70 30 00 6d 6d 5f 73 74 65 70 31 00 6d 6d 5f 73 74 65 70 32 00 ];
        vdec_freq = [ 6d 6d 5f 73 74 65 70 30 00 6d 6d 5f 73 74 65 70 31 00 6d 6d 5f 73 74 65 70 32 00 ];
        venc_freq = [ 6d 6d 5f 73 74 65 70 30 00 6d 6d 5f 73 74 65 70 31 00 6d 6d 5f 73 74 65 70 32 00 ];
        clocks = <0x1b 0x6b 0x1b 0x24 0x1b 0x1a 0x1b 0x25>;
        clock-names = [ 6d 6d 64 76 66 73 5f 63 6c 6b 5f 6d 6d 5f 73 65 6c 5f 63 6b 00 6d 6d 64 76 66 73 5f 63 6c 6b 5f 6d 6d 70 6c 6c 5f 63 6b 00 6d 6d 64 76 66 73 5f 63 6c 6b 5f 75 6e 69 76 70 6c 6c 31 5f 64 32 5f 63 6b 00 6d 6d 64 76 66 73 5f 63 6c 6b 5f 6d 6d 70 6c 6c 5f 64 32 5f 63 6b 00 ];
    };
    smi_larb0@14003000 {
        cell-index = <0x0>;
        compatible = [ 6d 65 64 69 61 74 65 6b 2c 73 6d 69 5f 6c 61 72 62 30 00 6d 65 64 69 61 74 65 6b 2c 73 6d 69 5f 6c 61 72 62 00 ];
        reg = <0x0 0x14003000 0x0 0x1000>;
        clocks = <0x22 0x3 0x23 0x14>;
        clock-names = [ 6d 74 63 6d 6f 73 2d 64 69 73 00 73 6d 69 2d 6c 61 72 62 30 00 ];
        linux,phandle = <0x1e>;
        phandle = <0x1e>;
    };
    mdp_rdma0@14004000 {
        compatible = "mediatek,mdp_rdma0";
        reg = <0x0 0x14004000 0x0 0x1000>;
        interrupts = <0x0 0x9b 0x8>;
        clocks = <0x23 0x0>;
        clock-names = "MDP_RDMA0";
        linux,phandle = <0x24>;
        phandle = <0x24>;
    };
    mdp_ccorr0@14005000 {
        compatible = "mediatek,mdp_ccorr0";
        reg = <0x0 0x14005000 0x0 0x1000>;
        interrupts = <0x0 0xaa 0x8>;
        clocks = <0x23 0x1>;
        clock-names = "MDP_CCORR";
        linux,phandle = <0x2b>;
        phandle = <0x2b>;
    };
    mdp_rsz0@14006000 {
        compatible = "mediatek,mdp_rsz0";
        reg = <0x0 0x14006000 0x0 0x1000>;
        interrupts = <0x0 0x9c 0x8>;
        clocks = <0x23 0x2>;
        clock-names = "MDP_RSZ0";
        linux,phandle = <0x25>;
        phandle = <0x25>;
    };
    mdp_rsz1@14007000 {
        compatible = "mediatek,mdp_rsz1";
        reg = <0x0 0x14007000 0x0 0x1000>;
        interrupts = <0x0 0x9d 0x8>;
        clocks = <0x23 0x3>;
        clock-names = "MDP_RSZ1";
        linux,phandle = <0x26>;
        phandle = <0x26>;
    };
    mdp_wdma0@14008000 {
        compatible = "mediatek,mdp_wdma0";
        reg = <0x0 0x14008000 0x0 0x1000>;
        interrupts = <0x0 0xa0 0x8>;
        clocks = <0x23 0x6>;
        clock-names = "MDP_WDMA";
        linux,phandle = <0x27>;
        phandle = <0x27>;
    };
    mdp_wrot0@14009000 {
        compatible = "mediatek,mdp_wrot0";
        reg = <0x0 0x14009000 0x0 0x1000>;
        interrupts = <0x0 0x9f 0x8>;
        clocks = <0x23 0x5>;
        clock-names = "MDP_WROT0";
        linux,phandle = <0x28>;
        phandle = <0x28>;
    };
    mdp_tdshp0@1400a000 {
        compatible = "mediatek,mdp_tdshp0";
        reg = <0x0 0x1400a000 0x0 0x1000>;
        clocks = <0x23 0x4>;
        clock-names = "MDP_TDSHP";
        linux,phandle = <0x29>;
        phandle = <0x29>;
    };
    disp_ovl0@1400b000 {
        compatible = "mediatek,disp_ovl0";
        reg = <0x0 0x1400b000 0x0 0x1000>;
        interrupts = <0x0 0xa1 0x8>;
    };
    disp_ovl0_2l@1400c000 {
        compatible = "mediatek,disp_ovl0_2l";
        reg = <0x0 0x1400c000 0x0 0x1000>;
        interrupts = <0x0 0xad 0x8>;
    };
    disp_rdma0@1400d000 {
        compatible = "mediatek,disp_rdma0";
        reg = <0x0 0x1400d000 0x0 0x1000>;
        interrupts = <0x0 0xa2 0x8>;
    };
    disp_wdma0@1400e000 {
        compatible = "mediatek,disp_wdma0";
        reg = <0x0 0x1400e000 0x0 0x1000>;
        interrupts = <0x0 0xa3 0x8>;
    };
    disp_color0@1400f000 {
        compatible = "mediatek,disp_color0";
        reg = <0x0 0x1400f000 0x0 0x1000>;
        interrupts = <0x0 0xa4 0x8>;
        linux,phandle = <0x2a>;
        phandle = <0x2a>;
    };
    disp_ccorr0@14010000 {
        compatible = "mediatek,disp_ccorr0";
        reg = <0x0 0x14010000 0x0 0x1000>;
        interrupts = <0x0 0xa5 0x8>;
    };
    disp_aal0@14011000 {
        compatible = "mediatek,disp_aal0";
        reg = <0x0 0x14011000 0x0 0x1000>;
        interrupts = <0x0 0xa6 0x8>;
    };
    disp_gamma0@14012000 {
        compatible = "mediatek,disp_gamma0";
        reg = <0x0 0x14012000 0x0 0x1000>;
        interrupts = <0x0 0xa7 0x8>;
    };
    disp_dither0@14013000 {
        compatible = "mediatek,disp_dither0";
        reg = <0x0 0x14013000 0x0 0x1000>;
        interrupts = <0x0 0xa8 0x8>;
    };
    dsi0@14014000 {
        compatible = "mediatek,dsi0";
        reg = <0x0 0x14014000 0x0 0x1000>;
        interrupts = <0x0 0xa9 0x8>;
    };
    disp_rsz0@14015000 {
        compatible = "mediatek,disp_rsz0";
        reg = <0x0 0x14015000 0x0 0x1000>;
        interrupts = <0x0 0xdc 0x8>;
    };
    mtkfb@0 {
        compatible = "mediatek,mtkfb";
        linux,phandle = <0x96>;
        phandle = <0x96>;
    };
    dispsys {
        compatible = "mediatek,dispsys";
        mediatek,larb = <0x1e>;
        clocks = <0x22 0x3 0x23 0x13 0x23 0x14 0x23 0x15 0x23 0x16 0x23 0x7 0x23 0x8 0x23 0xa 0x23 0xb 0x23 0xc 0x23 0xd 0x23 0xe 0x23 0xf 0x23 0x10 0x23 0x11 0x23 0x1c 0x23 0x1d 0x23 0x9 0x3c 0x13 0x1b 0x7c 0x21 0x31 0x1d 0x1b 0x1e 0x1b 0x2f 0x1b 0x31>;
        clock-names = [ 4d 4d 53 59 53 5f 4d 54 43 4d 4f 53 00 4d 4d 53 59 53 5f 53 4d 49 5f 43 4f 4d 4d 4f 4e 00 4d 4d 53 59 53 5f 53 4d 49 5f 4c 41 52 42 30 00 4d 4d 53 59 53 5f 47 41 4c 53 5f 43 4f 4d 4d 30 00 4d 4d 53 59 53 5f 47 41 4c 53 5f 43 4f 4d 4d 31 00 4d 4d 53 59 53 5f 44 49 53 50 5f 4f 56 4c 30 00 4d 4d 53 59 53 5f 44 49 53 50 5f 4f 56 4c 30 5f 32 4c 00 4d 4d 53 59 53 5f 44 49 53 50 5f 52 44 4d 41 30 00 4d 4d 53 59 53 5f 44 49 53 50 5f 57 44 4d 41 30 00 4d 4d 53 59 53 5f 44 49 53 50 5f 43 4f 4c 4f 52 30 00 4d 4d 53 59 53 5f 44 49 53 50 5f 43 43 4f 52 52 30 00 4d 4d 53 59 53 5f 44 49 53 50 5f 41 41 4c 30 00 4d 4d 53 59 53 5f 44 49 53 50 5f 47 41 4d 4d 41 30 00 4d 4d 53 59 53 5f 44 49 53 50 5f 44 49 54 48 45 52 30 00 4d 4d 53 59 53 5f 44 53 49 30 5f 4d 4d 5f 43 4b 00 4d 4d 53 59 53 5f 44 53 49 30 5f 49 46 5f 43 4b 00 4d 4d 53 59 53 5f 32 36 4d 00 4d 4d 53 59 53 5f 44 49 53 50 5f 52 53 5a 30 00 41 50 4d 49 58 45 44 5f 4d 49 50 49 5f 32 36 4d 00 54 4f 50 5f 4d 55 58 5f 44 49 53 50 5f 50 57 4d 00 44 49 53 50 5f 50 57 4d 00 54 4f 50 5f 32 36 4d 00 54 4f 50 5f 55 4e 49 56 50 4c 4c 32 5f 44 34 00 54 4f 50 5f 55 4c 50 4f 53 43 31 5f 44 32 00 54 4f 50 5f 55 4c 50 4f 53 43 31 5f 44 38 00 ];
    };
    dsi_te {
        compatible = "mediatek, DSI_TE-eint";
        status = "disabled";
        linux,phandle = <0x97>;
        phandle = <0x97>;
    };
    mm_mutex@14016000 {
        compatible = "mediatek,mm_mutex";
        reg = <0x0 0x14016000 0x0 0x1000>;
        linux,phandle = <0x98>;
        phandle = <0x98>;
    };
    camsys@15000000 {
        compatible = [ 6d 65 64 69 61 74 65 6b 2c 63 61 6d 73 79 73 00 73 79 73 63 6f 6e 00 ];
        reg = <0x0 0x15000000 0x0 0x1000>;
        #clock-cells = <0x1>;
        linux,phandle = <0x3d>;
        phandle = <0x3d>;
    };
    ispsys@15000000 {
        compatible = "mediatek,mt6761-ispsys";
        reg = <0x0 0x15004000 0x0 0x9000 0x0 0x1500d000 0x0 0x1000 0x0 0x15000000 0x0 0x52000 0x0 0x15040000 0x0 0x8000 0x0 0x10215000 0x0 0x3000 0x0 0x10211000 0x0 0x1000>;
        interrupts = <0x0 0xb3 0x8 0x0 0xb4 0x8 0x0 0xb5 0x8 0x0 0xb8 0x8 0x0 0xb9 0x8 0x0 0xba 0x8 0x0 0xbb 0x8>;
        clocks = <0x22 0x3 0x22 0x8 0x3d 0x0 0x3d 0x1 0x3d 0x2 0x3d 0x3 0x3d 0x4 0x3d 0x5 0x23 0x15 0x23 0x16 0x23 0x13>;
        clock-names = [ 43 47 5f 53 43 50 5f 53 59 53 5f 44 49 53 00 43 47 5f 53 43 50 5f 53 59 53 5f 43 41 4d 00 43 47 5f 43 41 4d 5f 4c 41 52 42 32 00 43 47 5f 43 41 4d 00 43 47 5f 43 41 4d 54 47 00 43 47 5f 43 41 4d 5f 53 45 4e 49 4e 46 00 43 47 5f 43 41 4d 53 56 30 00 43 47 5f 43 41 4d 53 56 31 00 43 47 5f 4d 4d 5f 53 4d 49 5f 43 4f 4d 4d 30 00 43 47 5f 4d 4d 5f 53 4d 49 5f 43 4f 4d 4d 31 00 43 47 5f 4d 4d 5f 53 4d 49 5f 43 4f 4d 4d 4f 4e 00 ];
    };
    smi_larb2@15001000 {
        cell-index = <0x2>;
        compatible = [ 6d 65 64 69 61 74 65 6b 2c 73 6d 69 5f 6c 61 72 62 32 00 6d 65 64 69 61 74 65 6b 2c 73 6d 69 5f 6c 61 72 62 00 ];
        reg = <0x0 0x15001000 0x0 0x1000>;
        clocks = <0x22 0x8 0x23 0x18 0x3d 0x0>;
        clock-names = [ 6d 74 63 6d 6f 73 2d 63 61 6d 00 67 61 6c 73 2d 63 61 6d 32 69 6d 67 00 63 61 6d 2d 6c 61 72 62 32 00 ];
        linux,phandle = <0x20>;
        phandle = <0x20>;
    };
    cam@15004000 {
        compatible = "mediatek,cam";
        reg = <0x0 0x15004000 0x0 0x1000>;
    };
    cam_lut@15005000 {
        compatible = "mediatek,cam_lut";
        reg = <0x0 0x15005000 0x0 0x1000>;
    };
    camd@15006000 {
        compatible = "mediatek,camd";
        reg = <0x0 0x15006000 0x0 0x1000>;
    };
    cam_dma@15007000 {
        compatible = "mediatek,cam_dma";
        reg = <0x0 0x15007000 0x0 0x1000>;
    };
    fdvt@1500b000 {
        compatible = "mediatek,fdvt";
        reg = <0x0 0x1500b000 0x0 0x1000>;
        interrupts = <0x0 0xb6 0x8>;
        clocks = <0x3d 0x6>;
        clock-names = "FD_CLK_CAM_FDVT";
    };
    cam_inner@1500d000 {
        compatible = "mediatek,cam_inner";
        reg = <0x0 0x1500d000 0x0 0x1000>;
    };
    camd_inner@1500e000 {
        compatible = "mediatek,camd_inner";
        reg = <0x0 0x1500e000 0x0 0x1000>;
    };
    cam_inner_dma@1500f000 {
        compatible = "mediatek,cam_inner_dma";
        reg = <0x0 0x1500f000 0x0 0x1000>;
    };
    camsv0@15050000 {
        compatible = "mediatek,camsv0";
        reg = <0x0 0x15050000 0x0 0x1000>;
    };
    camsv1@15051000 {
        compatible = "mediatek,camsv1";
        reg = <0x0 0x15051000 0x0 0x1000>;
    };
    kd_camera_hw1@15040000 {
        compatible = "mediatek,camera_hw";
        reg = <0x0 0x15040000 0x0 0x1000>;
        clocks = <0x1b 0x6f 0x1b 0x70 0x1b 0x71 0x1b 0x72 0x1b 0x16 0x1b 0x15 0x1b 0x20 0x1b 0x13 0x1b 0x1f 0x1b 0x14 0x1d 0x3d 0x3 0x3c 0xc 0x3c 0x10 0x3e 0x0 0x3f 0x0 0x40 0x0 0x41 0x0 0x42 0x0 0x43 0x0 0x1b 0x86 0x1b 0x1d 0x22 0x8>;
        clock-names = [ 43 4c 4b 5f 54 4f 50 5f 43 41 4d 54 47 5f 53 45 4c 00 43 4c 4b 5f 54 4f 50 5f 43 41 4d 54 47 31 5f 53 45 4c 00 43 4c 4b 5f 54 4f 50 5f 43 41 4d 54 47 32 5f 53 45 4c 00 43 4c 4b 5f 54 4f 50 5f 43 41 4d 54 47 33 5f 53 45 4c 00 43 4c 4b 5f 4d 43 4c 4b 5f 36 4d 00 43 4c 4b 5f 4d 43 4c 4b 5f 31 32 4d 00 43 4c 4b 5f 4d 43 4c 4b 5f 31 33 4d 00 43 4c 4b 5f 4d 43 4c 4b 5f 34 38 4d 00 43 4c 4b 5f 4d 43 4c 4b 5f 35 32 4d 00 43 4c 4b 5f 4d 43 4c 4b 5f 32 34 4d 00 43 4c 4b 5f 4d 43 4c 4b 5f 32 36 4d 00 43 4c 4b 5f 43 41 4d 5f 53 45 4e 49 4e 46 5f 43 47 00 43 4c 4b 5f 4d 49 50 49 5f 43 30 5f 32 36 4d 5f 43 47 00 43 4c 4b 5f 4d 49 50 49 5f 43 31 5f 32 36 4d 5f 43 47 00 43 4c 4b 5f 4d 49 50 49 5f 41 4e 41 5f 30 41 5f 43 47 00 43 4c 4b 5f 4d 49 50 49 5f 41 4e 41 5f 30 42 5f 43 47 00 43 4c 4b 5f 4d 49 50 49 5f 41 4e 41 5f 31 41 5f 43 47 00 43 4c 4b 5f 4d 49 50 49 5f 41 4e 41 5f 31 42 5f 43 47 00 43 4c 4b 5f 4d 49 50 49 5f 41 4e 41 5f 32 41 5f 43 47 00 43 4c 4b 5f 4d 49 50 49 5f 41 4e 41 5f 32 42 5f 43 47 00 43 4c 4b 5f 54 4f 50 5f 43 41 4d 54 4d 5f 53 45 4c 5f 43 47 00 43 4c 4b 5f 54 4f 50 5f 43 41 4d 54 4d 5f 32 30 38 5f 43 47 00 43 4c 4b 5f 53 43 50 5f 53 59 53 5f 43 41 4d 00 ];
        linux,phandle = <0x99>;
        phandle = <0x99>;
    };
    flashlight_core {
        compatible = "mediatek,flashlight_core";
        linux,phandle = <0x9a>;
        phandle = <0x9a>;
    };
    flashlights_mt6370 {
        compatible = "mediatek,flashlights_mt6370";
        decouple = <0x0>;
        linux,phandle = <0x9b>;
        phandle = <0x9b>;
        channel@1 {
            type = <0x0>;
            ct = <0x0>;
            part = <0x0>;
        };
        channel@2 {
            type = <0x0>;
            ct = <0x1>;
            part = <0x0>;
        };
    };
    venc_gcon@17000000 {
        compatible = [ 6d 65 64 69 61 74 65 6b 2c 76 65 6e 63 5f 67 63 6f 6e 00 73 79 73 63 6f 6e 00 ];
        reg = <0x0 0x17000000 0x0 0x10000>;
        clocks = <0x22 0x3 0x22 0x9 0x23 0x15 0x23 0x16 0x23 0x13 0x44 0x3 0x44 0x1>;
        clock-names = [ 4d 54 5f 53 43 50 5f 53 59 53 5f 44 49 53 00 4d 54 5f 53 43 50 5f 53 59 53 5f 56 43 4f 44 45 43 00 4d 54 5f 43 47 5f 4d 4d 5f 53 4d 49 5f 43 4f 4d 4d 30 00 4d 54 5f 43 47 5f 4d 4d 5f 53 4d 49 5f 43 4f 4d 4d 31 00 4d 54 5f 43 47 5f 4d 4d 5f 53 4d 49 5f 43 4f 4d 4d 4f 4e 00 4d 54 5f 43 47 5f 56 44 45 43 00 4d 54 5f 43 47 5f 56 45 4e 43 00 ];
        #clock-cells = <0x1>;
        linux,phandle = <0x44>;
        phandle = <0x44>;
    };
    smi_larb1@17010000 {
        cell-index = <0x1>;
        compatible = [ 6d 65 64 69 61 74 65 6b 2c 73 6d 69 5f 6c 61 72 62 31 00 6d 65 64 69 61 74 65 6b 2c 73 6d 69 5f 6c 61 72 62 00 ];
        reg = <0x0 0x17010000 0x0 0x10000>;
        clocks = <0x22 0x9 0x44 0x1>;
        clock-names = [ 6d 74 63 6d 6f 73 2d 76 63 6f 64 65 63 00 76 65 6e 63 2d 6c 61 72 62 31 00 ];
        linux,phandle = <0x1f>;
        phandle = <0x1f>;
    };
    venc@17020000 {
        compatible = "mediatek,venc";
        reg = <0x0 0x17020000 0x0 0x10000>;
        interrupts = <0x0 0xae 0x8>;
    };
    venc_jpg@17030000 {
        compatible = "mediatek,venc_jpg";
        reg = <0x0 0x17030000 0x0 0x10000>;
        interrupts = <0x0 0xb0 0x8>;
        clocks = <0x44 0x2>;
        clock-names = "MT_CG_VENC_JPGENC";
    };
    vdec@17040000 {
        compatible = "mediatek,vdec";
        reg = <0x0 0x17040000 0x0 0x10000>;
        interrupts = <0x0 0xb1 0x8>;
    };
    mbist@17050000 {
        compatible = "mediatek,mbist";
        reg = <0x0 0x17050000 0x0 0x10000>;
    };
    otg_iddig {
        compatible = "mediatek,usb_iddig_bi_eint";
        linux,phandle = <0x9c>;
        phandle = <0x9c>;
    };
    odm {
        compatible = "simple-bus";
        linux,phandle = <0x9d>;
        phandle = <0x9d>;
    };
    radio_md_cfg {
        compatible = "mediatek,radio_md_cfg";
        linux,phandle = <0x9e>;
        phandle = <0x9e>;
    };
    dynamic_options {
        compatible = "mediatek,dynamic_options";
        linux,phandle = <0x9f>;
        phandle = <0x9f>;
    };
    audio_snd_card {
        compatible = "mediatek,audio_snd_card";
    };
    mt_soc_deep_buffer_dl_pcm {
        compatible = "mediatek,mt_soc_pcm_deep_buffer_dl";
    };
    mt_soc_ul1_pcm {
        compatible = "mediatek,mt_soc_pcm_capture";
    };
    mt_soc_voice_md1 {
        compatible = "mediatek,mt_soc_pcm_voice_md1";
    };
    mt_soc_uldlloopback_pcm {
        compatible = "mediatek,mt_soc_pcm_uldlloopback";
    };
    mt_soc_i2s0_pcm {
        compatible = "mediatek,mt_soc_pcm_dl1_i2s0";
    };
    mt_soc_mrgrx_pcm {
        compatible = "mediatek,mt_soc_pcm_mrgrx";
    };
    mt_soc_mrgrx_awb_pcm {
        compatible = "mediatek,mt_soc_pcm_mrgrx_awb";
    };
    mt_soc_fm_i2s_pcm {
        compatible = "mediatek,mt_soc_pcm_fm_i2s";
    };
    mt_soc_fm_i2s_awb_pcm {
        compatible = "mediatek,mt_soc_pcm_fm_i2s_awb";
    };
    mt_soc_i2s0dl1_pcm {
        compatible = "mediatek,mt_soc_pcm_dl1_i2s0dl1";
    };
    mt_soc_dl1_awb_pcm {
        compatible = "mediatek,mt_soc_pcm_dl1_awb";
    };
    mt_soc_voice_md1_bt {
        compatible = "mediatek,mt_soc_pcm_voice_md1_bt";
    };
    mt_soc_voip_bt_out {
        compatible = "mediatek,mt_soc_pcm_dl1_bt";
    };
    mt_soc_voip_bt_in {
        compatible = "mediatek,mt_soc_pcm_bt_dai";
    };
    mt_soc_tdmrx_pcm {
        compatible = "mediatek,mt_soc_tdm_capture";
    };
    mt_soc_fm_mrgtx_pcm {
        compatible = "mediatek,mt_soc_pcm_fmtx";
    };
    mt_soc_ul2_pcm {
        compatible = "mediatek,mt_soc_pcm_capture2";
    };
    mt_soc_i2s0_awb_pcm {
        compatible = "mediatek,mt_soc_pcm_i2s0_awb";
    };
    mt_soc_voice_md2 {
        compatible = "mediatek,mt_soc_pcm_voice_md2";
    };
    mt_soc_routing_pcm {
        compatible = "mediatek,mt_soc_pcm_routing";
    };
    mt_soc_voice_md2_bt {
        compatible = "mediatek,mt_soc_pcm_voice_md2_bt";
    };
    mt_soc_hp_impedance_pcm {
        compatible = "mediatek,mt_soc_pcm_hp_impedance";
    };
    mt_soc_codec_name {
        compatible = "mediatek,mt_soc_codec_63xx";
        use_hp_depop_flow = <0x0>;
        use_ul_260k = <0x0>;
    };
    mt_soc_dummy_pcm {
        compatible = "mediatek,mt_soc_pcm_dummy";
    };
    mt_soc_codec_dummy_name {
        compatible = "mediatek,mt_soc_codec_dummy";
    };
    mt_soc_routing_dai_name {
        compatible = "mediatek,mt_soc_dai_routing";
    };
    mt_soc_dai_name {
        compatible = "mediatek,mt_soc_dai_stub";
    };
    mt_soc_dl2_pcm {
        compatible = "mediatek,mt_soc_pcm_dl2";
    };
    mt_soc_anc_pcm {
        compatible = "mediatek,mt_soc_pcm_anc";
    };
    mt_soc_pcm_voice_ultra {
        compatible = "mediatek,mt_soc_pcm_voice_ultra";
    };
    mt_soc_pcm_voice_usb {
        compatible = "mediatek,mt_soc_pcm_voice_usb";
    };
    mt_soc_pcm_voice_usb_echoref {
        compatible = "mediatek,mt_soc_pcm_voice_usb_echoref";
    };
    mt_soc_btcvsd_rx_pcm {
        compatible = "mediatek,mt_soc_btcvsd_rx_pcm";
    };
    mt_soc_btcvsd_tx_pcm {
        compatible = "mediatek,mt_soc_btcvsd_tx_pcm";
    };
    firmware {
        android {
            compatible = "android,firmware";
            vbmeta {
                compatible = "android,vbmeta";
                parts = "vbmeta,boot,system,vendor,recovery";
            };
            fstab {
                compatible = "android,fstab";
                vendor {
                    compatible = "android,vendor";
                    dev = "/dev/block/platform/bootdevice/by-name/vendor";
                    type = "ext4";
                    mnt_flags = "ro";
                    fsmgr_flags = "wait,avb";
                };
            };
        };
    };
    mt_charger {
        compatible = "mediatek,mt-charger";
        linux,phandle = <0xa0>;
        phandle = <0xa0>;
    };
    lk_charger {
        compatible = "mediatek,lk_charger";
        enable_anime;
        enable_pe_plus;
        power_path_support;
        max_charger_voltage = <0x632ea0>;
        fast_charge_voltage = <0x2dc6c0>;
        usb_charger_current = <0x7a120>;
        ac_charger_current = <0xc3500>;
        ac_charger_input_current = <0xc3500>;
        non_std_ac_charger_current = <0x7a120>;
        charging_host_charger_current = <0x16e360>;
        ta_ac_charger_current = <0x2dc6c0>;
        pd_charger_current = <0x7a120>;
        temp_t4_threshold = <0x32>;
        temp_t3_threshold = <0x2d>;
        temp_t1_threshold = <0x0>;
        linux,phandle = <0xa1>;
        phandle = <0xa1>;
    };
    charger {
        compatible = "mediatek,charger";
        algorithm_name = "SwitchCharging";
        enable_sw_jeita;
        battery_cv = <0x432380>;
        max_charger_voltage = <0x5d1420>;
        min_charger_voltage = <0x4630c0>;
        usb_charger_current_suspend = <0x0>;
        usb_charger_current_unconfigured = <0x11170>;
        usb_charger_current_configured = <0x7a120>;
        usb_charger_current = <0x7a120>;
        ac_charger_current = <0x100590>;
        ac_charger_input_current = <0x10c8e0>;
        non_std_ac_charger_current = <0x7a120>;
        charging_host_charger_current = <0x7a120>;
        apple_1_0a_charger_current = <0x9eb10>;
        apple_2_1a_charger_current = <0xc3500>;
        ta_ac_charger_current = <0x2dc6c0>;
        jeita_temp_above_t4_cv = <0x3dcc50>;
        jeita_temp_t3_to_t4_cv = <0x3dcc50>;
        jeita_temp_t2_to_t3_cv = <0x432380>;
        jeita_temp_t1_to_t2_cv = <0x432380>;
        jeita_temp_t0_to_t1_cv = <0x432380>;
        jeita_temp_below_t0_cv = <0x432380>;
        temp_t4_thres = <0x3c>;
        temp_t4_thres_minus_x_degree = <0x39>;
        temp_t3_thres = <0x2d>;
        temp_t3_thres_minus_x_degree = <0x27>;
        temp_t2_thres = <0xf>;
        temp_t2_thres_plus_x_degree = <0x15>;
        temp_t1_thres = <0x5>;
        temp_t1_thres_plus_x_degree = <0xb>;
        temp_t0_thres = <0x0>;
        temp_t0_thres_plus_x_degree = <0x0>;
        temp_neg_10_thres = <0x0>;
        enable_min_charge_temp;
        min_charge_temp = <0x0>;
        min_charge_temp_plus_x_degree = <0x6>;
        max_charge_temp = <0x32>;
        max_charge_temp_minus_x_degree = <0x2f>;
        ta_12v_support;
        ta_9v_support;
        pe_ichg_level_threshold = <0xf4240>;
        ta_ac_12v_input_current = <0x30d400>;
        ta_ac_9v_input_current = <0x30d400>;
        ta_ac_7v_input_current = <0x30d400>;
        pe20_ichg_level_threshold = <0xf4240>;
        ta_start_battery_soc = <0x0>;
        ta_stop_battery_soc = <0x55>;
        pe40_single_charger_input_current = <0x2dc6c0>;
        pe40_single_charger_current = <0x2dc6c0>;
        pe40_dual_charger_input_current = <0x2dc6c0>;
        pe40_dual_charger_chg1_current = <0x1e8480>;
        pe40_dual_charger_chg2_current = <0x1e8480>;
        pe40_stop_battery_soc = <0x50>;
        pe40_r_cable_1a_lower = <0x212>;
        pe40_r_cable_2a_lower = <0x186>;
        pe40_r_cable_3a_lower = <0xfc>;
        chg1_ta_ac_charger_current = <0x16e360>;
        chg2_ta_ac_charger_current = <0x16e360>;
        cable_imp_threshold = <0x2bb>;
        vbat_cable_imp_threshold = <0x3b8260>;
        bif_threshold1 = <0x40d990>;
        bif_threshold2 = <0x419ce0>;
        bif_cv_under_threshold2 = <0x43e6d0>;
        linux,phandle = <0xa2>;
        phandle = <0xa2>;
    };
    rt9465_slave_chr {
        compatible = "richtek,rt9465";
        status = "disabled";
        linux,phandle = <0xa3>;
        phandle = <0xa3>;
    };
    rt-pd-manager {
        compatible = "mediatek,rt-pd-manager";
    };
    mt6370_pmu_eint {
        linux,phandle = <0xa4>;
        phandle = <0xa4>;
    };
    pmic_clock_buffer_ctrl {
        compatible = "mediatek,pmic_clock_buffer";
        mediatek,clkbuf-quantity = <0x7>;
        mediatek,clkbuf-config = <0x2 0x1 0x1 0x2 0x0 0x0 0x0>;
        mediatek,clkbuf-driving-current = <0x1 0x1 0x1 0x1 0x1 0x1 0x1>;
        linux,phandle = <0xa5>;
        phandle = <0xa5>;
    };
    pseudo_m4u {
        compatible = "mediatek,mt-pseudo_m4u";
        iommus = <0x45 0x2>;
    };
    pseudo_m4u-larb0 {
        compatible = "mediatek,mt-pseudo_m4u-port";
        mediatek,larbid = <0x0>;
        iommus = <0x45 0x0 0x45 0x1 0x45 0x2 0x45 0x3 0x45 0x4 0x45 0x5 0x45 0x6 0x45 0x7>;
    };
    pseudo_m4u-larb1 {
        compatible = "mediatek,mt-pseudo_m4u-port";
        mediatek,larbid = <0x1>;
        iommus = <0x45 0x20 0x45 0x21>;
    };
    pseudo_m4u-larb2 {
        compatible = "mediatek,mt-pseudo_m4u-port";
        mediatek,larbid = <0x2>;
        iommus = <0x45 0x40 0x45 0x41>;
    };
    trusty {
        compatible = "android,trusty-smc-v1";
        ranges;
        #address-cells = <0x2>;
        #size-cells = <0x2>;
        irq {
            compatible = "android,trusty-irq-v1";
            ppi-interrupt-parent = <0xf>;
        };
        log {
            compatible = "android,trusty-log-v1";
        };
        virtio {
            compatible = "android,trusty-virtio-v1";
        };
        mtee {
            compatible = "mediatek,trusty-mtee-v1";
        };
    };
    mt6370_pmu_dts {
        interrupt-controller;
        #interrupt-cells = <0x1>;
        mt6370,intr_gpio_num = <0x3>;
        mt6370,intr_gpio = <0xe 0x3 0x0>;
        linux,phandle = <0xa6>;
        phandle = <0xa6>;
        core {
            compatible = "mediatek,mt6370_pmu_core";
            interrupt-names = [ 6f 74 70 00 76 64 64 61 5f 6f 76 70 00 76 64 64 61 5f 75 76 00 ];
            i2cstmr_rst_tmr = <0x0>;
            mrstb_en;
            mrstb_tmr = <0x3>;
            int_wdt = <0x0>;
            int_deg = <0x0>;
        };
        charger {
            compatible = "mediatek,mt6370_pmu_charger";
            interrupt-names = [ 63 68 67 5f 6d 69 76 72 00 63 68 67 5f 61 69 63 6c 6d 65 61 73 69 00 61 74 74 61 63 68 69 00 6f 76 70 63 74 72 6c 5f 75 76 70 5f 64 5f 65 76 74 00 63 68 67 5f 77 64 74 6d 72 69 00 63 68 67 5f 76 62 75 73 6f 76 00 63 68 67 5f 74 6d 72 69 00 63 68 67 5f 74 72 65 67 00 ];
            charger_name = "primary_chg";
            load_switch_name = "primary_load_switch";
            ichg = <0x1e8480>;
            aicr = <0x7a120>;
            mivr = <0x432380>;
            cv = <0x426030>;
            ieoc = <0x249f0>;
            safety_timer = <0xc>;
            dc_wdt = <0x3d0900>;
            ircmp_resistor = <0x61a8>;
            ircmp_vclamp = <0x7d00>;
            enable_te;
            enable_wdt;
        };
        mt6370_pmu_fled1 {
            compatible = "mediatek,mt6370_pmu_fled1";
            interrupt-names = [ 66 6c 65 64 5f 6c 76 66 00 66 6c 65 64 32 5f 73 68 6f 72 74 00 66 6c 65 64 31 5f 73 68 6f 72 74 00 ];
            fled_enable = <0x1>;
            torch_cur = <0x493e0>;
            strobe_cur = <0x124f80>;
            strobe_timeout = <0x960>;
        };
        mt6370_pmu_fled2 {
            compatible = "mediatek,mt6370_pmu_fled2";
            fled_enable = <0x1>;
            torch_cur = <0x30d40>;
            strobe_cur = <0xf4240>;
            strobe_timeout = <0x4b0>;
        };
        ldo {
            compatible = "mediatek,mt6370_pmu_ldo";
            interrupt-names = "ldo_oc";
            ldo_oms = <0x1>;
            ldo_vrc_lt = <0x1>;
            mt6370_ldo {
                regulator-name = "irtx_ldo";
                regulator-min-microvolt = <0x186a00>;
                regulator-max-microvolt = <0x3d0900>;
            };
        };
        rgbled {
            compatible = "mediatek,mt6370_pmu_rgbled";
            interrupt-names = <0x6973696e 0x6b345f73 0x686f7274 0x697369 0x6e6b335f 0x73686f72 0x74006973 0x696e6b32 0x5f73686f 0x72740069 0x73696e6b 0x315f7368 0x6f727400 0x6973696e 0x6b345f6f 0x70656e00 0x6973696e 0x6b335f6f 0x70656e00 0x6973696e 0x6b325f6f 0x70656e00 0x6973696e 0x6b315f6f 0x70656e00>;
            mt,led_name = <0x6d743633 0x37305f70 0x6d755f6c 0x65643100 0x6d743633 0x37305f70 0x6d755f6c 0x65643200 0x6d743633 0x37305f70 0x6d755f6c 0x65643300 0x6d743633 0x37305f70 0x6d755f6c 0x65643400>;
            mt,led_default_trigger = [ 63 63 5f 6d 6f 64 65 00 63 63 5f 6d 6f 64 65 00 63 63 5f 6d 6f 64 65 00 6e 6f 6e 65 00 ];
        };
        bled {
            compatible = "mediatek,mt6370_pmu_bled";
            interrupt-names = "bled_ocp";
            mt,bled_name = "mt6370_pmu_bled";
            mt,chan_en = <0xf>;
            mt,map_linear;
            mt,bl_ovp_level = <0x3>;
            mt,bl_ocp_level = <0x2>;
            mt,use_pwm;
            mt,pwm_fsample = <0x2>;
            mt,pwm_deglitch = <0x1>;
            mt,pwm_avg_cycle = <0x0>;
            mt,bled_ramptime = <0x3>;
            mt,bled_flash_ramp = <0x1>;
            mt,max_bled_brightness = <0x200>;
        };
        dsv {
            compatible = "mediatek,mt6370_pmu_dsv";
            interrupt-names = <0x6473765f 0x766e6567 0x5f6f6370 0x647376 0x5f76706f 0x735f6f63 0x70006473 0x765f6273 0x745f6f63 0x70006473 0x765f766e 0x65675f73 0x63700064 0x73765f76 0x706f735f 0x73637000>;
            db_ext_en = <0x0>;
            db_periodic_fix = <0x0>;
            db_single_pin = <0x0>;
            db_freq_pm = <0x0>;
            db_periodic_mode = <0x0>;
            db_startup = <0x0>;
            db_vneg_20ms = <0x1>;
            db_vneg_disc = <0x0>;
            db_vpos_20ms = <0x1>;
            db_vpos_disc = <0x0>;
            db_delay = <0x3>;
            db_vbst = <0x1644>;
            db_vpos_slew = <0x1>;
            db_vneg_slew = <0x1>;
            mt6370_dsvp {
                regulator-name = "dsv_pos";
                regulator-min-microvolt = <0x3d0900>;
                regulator-max-microvolt = <0x5b8d80>;
            };
            mt6370_dsvn {
                regulator-name = "dsv_neg";
                regulator-min-microvolt = <0x3d0900>;
                regulator-max-microvolt = <0x5b8d80>;
            };
        };
    };
    type_c_port0 {
        tcpc-dual,supported_modes = <0x0>;
        mt-tcpc,name = "type_c_port0";
        mt-tcpc,role_def = <0x4>;
        mt-tcpc,rp_level = <0x0>;
        mt-tcpc,vconn_supply = <0x1>;
        mt6370pd,intr_gpio = <0xe 0x18 0x0>;
        mt6370pd,intr_gpio_num = <0x18>;
        linux,phandle = <0xa7>;
        phandle = <0xa7>;
        pd-data {
            pd,vid = <0x29cf>;
            pd,pid = <0x5081>;
            pd,source-cap-ext = <0x171129cf 0x0 0x102 0x0 0x0 0x2000000>;
            pd,mfrs = "RichtekTCPC";
            pd,charging_policy = <0x21>;
            pd,source-pdo-size = <0x1>;
            pd,source-pdo-data = <0x19032>;
            pd,sink-pdo-size = <0x2>;
            pd,sink-pdo-data = <0x190c8 0xc0761e3c>;
            pd,id-vdo-size = <0x3>;
            pd,id-vdo-data = <0xd10029cf 0x0 0x10000>;
            bat,nr = <0x1>;
            pd,country_nr = <0x0>;
            bat-info0 {
                bat,vid = <0x29cf>;
                bat,pid = <0x1711>;
                bat,mfrs = "bat1";
                bat,design_cap = <0xbb8>;
            };
        };
        dpm_caps {
            local_dr_power;
            local_dr_data;
            local_usb_comm;
            local_no_suspend;
            local_vconn_supply;
            attemp_enter_dp_mode;
            attemp_discover_cable;
            attemp_discover_id;
            pr_check = <0x0>;
            pr_check_gp_source;
            dr_check = <0x0>;
        };
    };
    __symbols__ {
        chosen = "/chosen";
        cpu0 = "/cpus/cpu@000";
        cpu1 = "/cpus/cpu@001";
        cpu2 = "/cpus/cpu@002";
        cpu3 = "/cpus/cpu@003";
        STANDBY = "/cpus/idle-states/standby";
        MCDI_CPU = "/cpus/idle-states/mcdi-cpu";
        MCDI_CLUSTER = "/cpus/idle-states/mcdi-cluster";
        SODI = "/cpus/idle-states/sodi";
        SODI3 = "/cpus/idle-states/sodi3";
        DPIDLE = "/cpus/idle-states/dpidle";
        SUSPEND = "/cpus/idle-states/suspend";
        gpio_keys = "/gpio-keys";
        cpu_dbgapb = "/cpu_dbgapb@0d410000";
        gic = "/interrupt-controller@0c000000";
        sysirq = "/intpol-controller@10200a80";
        infracfg_ao = "/infracfg_ao@10001000";
        scpsys = "/scpsys@10001000";
        topckgen = "/topckgen@10000000";
        syscfg_pctl_1 = "/syscfg_pctl_1@10002000";
        syscfg_pctl_2 = "/syscfg_pctl_2@10002200";
        syscfg_pctl_3 = "/syscfg_pctl_3@10002400";
        syscfg_pctl_4 = "/syscfg_pctl_4@10002600";
        syscfg_pctl_5 = "/syscfg_pctl_5@10002800";
        syscfg_pctl_6 = "/syscfg_pctl_6@10002a00";
        syscfg_pctl_7 = "/syscfg_pctl_7@10002c00";
        pericfg = "/pericfg@10003000";
        smart_pa = "/smart_pa";
        tcpc_pd = "/tcpc_pd";
        md1_sim1_hot_plug_eint = "/md1_sim1_hot_plug_eint";
        md1_sim2_hot_plug_eint = "/md1_sim2_hot_plug_eint";
        gpio_usage_mapping = "/gpio";
        gpio = "/gpio@10005000";
        syscfg_pctl_0 = "/syscfg_pctl_0@10005000";
        pio = "/pinctrl@1000b000";
        function_key = "/pinctrl@1000b000/eint60default";
        msdc0_pins_default = "/pinctrl@1000b000/msdc0@default";
        msdc0_pins_hs400 = "/pinctrl@1000b000/msdc0@hs400";
        msdc0_pins_hs200 = "/pinctrl@1000b000/msdc0@hs200";
        msdc0_register_setting_default = "/pinctrl@1000b000/msdc0@register_default";
        msdc1_pins_default = "/pinctrl@1000b000/msdc1@default";
        msdc1_pins_sdr104 = "/pinctrl@1000b000/msdc1@sdr104";
        msdc1_pins_sdr50 = "/pinctrl@1000b000/msdc1@sdr50";
        msdc1_pins_ddr50 = "/pinctrl@1000b000/msdc1@ddr50";
        msdc1_register_setting_default = "/pinctrl@1000b000/msdc1@register_default";
        msdc3_pins_default = "/pinctrl@1000b000/msdc3@default";
        msdc3_register_setting_default = "/pinctrl@1000b000/msdc3@register_default";
        clk26m = "/clocks/clk26m";
        clk32k = "/clocks/clk32k";
        timer = "/timer@10008000";
        apmixed = "/apmixed@1000c000";
        main_pmic = "/mt-pmic";
        pmic_auxadc = "/mt-pmic/mt635x-auxadc";
        mt_pmic_vs1_buck_reg = "/mt-pmic/buck_regulators/buck_vs1";
        mt_pmic_vmodem_buck_reg = "/mt-pmic/buck_regulators/buck_vmodem";
        mt_pmic_vcore_buck_reg = "/mt-pmic/buck_regulators/buck_vcore";
        mt_pmic_vproc_buck_reg = "/mt-pmic/buck_regulators/buck_vproc";
        mt_pmic_vpa_buck_reg = "/mt-pmic/buck_regulators/buck_vpa";
        mt_pmic_vfe28_ldo_reg = "/mt-pmic/ldo_regulators/ldo_vfe28";
        mt_pmic_vxo22_ldo_reg = "/mt-pmic/ldo_regulators/ldo_vxo22";
        mt_pmic_vrf18_ldo_reg = "/mt-pmic/ldo_regulators/ldo_vrf18";
        mt_pmic_vrf12_ldo_reg = "/mt-pmic/ldo_regulators/ldo_vrf12";
        mt_pmic_vefuse_ldo_reg = "/mt-pmic/ldo_regulators/ldo_vefuse";
        mt_pmic_vcn33_bt_ldo_reg = "/mt-pmic/ldo_regulators/ldo_vcn33_bt";
        mt_pmic_vcn33_wifi_ldo_reg = "/mt-pmic/ldo_regulators/ldo_vcn33_wifi";
        mt_pmic_vcn28_ldo_reg = "/mt-pmic/ldo_regulators/ldo_vcn28";
        mt_pmic_vcn18_ldo_reg = "/mt-pmic/ldo_regulators/ldo_vcn18";
        mt_pmic_vcama_ldo_reg = "/mt-pmic/ldo_regulators/ldo_vcama";
        mt_pmic_vcamd_ldo_reg = "/mt-pmic/ldo_regulators/ldo_vcamd";
        mt_pmic_vcamio_ldo_reg = "/mt-pmic/ldo_regulators/ldo_vcamio";
        mt_pmic_vldo28_ldo_reg = "/mt-pmic/ldo_regulators/ldo_vldo28";
        mt_pmic_vsram_others_ldo_reg = "/mt-pmic/ldo_regulators/ldo_vsram_others";
        mt_pmic_vsram_proc_ldo_reg = "/mt-pmic/ldo_regulators/ldo_vsram_proc";
        mt_pmic_vaux18_ldo_reg = "/mt-pmic/ldo_regulators/ldo_vaux18";
        mt_pmic_vaud28_ldo_reg = "/mt-pmic/ldo_regulators/ldo_vaud28";
        mt_pmic_vio28_ldo_reg = "/mt-pmic/ldo_regulators/ldo_vio28";
        mt_pmic_vio18_ldo_reg = "/mt-pmic/ldo_regulators/ldo_vio18";
        mt_pmic_vdram_ldo_reg = "/mt-pmic/ldo_regulators/ldo_vdram";
        mt_pmic_vmc_ldo_reg = "/mt-pmic/ldo_regulators/ldo_vmc";
        mt_pmic_vmch_ldo_reg = "/mt-pmic/ldo_regulators/ldo_vmch";
        mt_pmic_vemc_ldo_reg = "/mt-pmic/ldo_regulators/ldo_vemc";
        mt_pmic_vsim1_ldo_reg = "/mt-pmic/ldo_regulators/ldo_vsim1";
        mt_pmic_vsim2_ldo_reg = "/mt-pmic/ldo_regulators/ldo_vsim2";
        mt_pmic_vibr_ldo_reg = "/mt-pmic/ldo_regulators/ldo_vibr";
        mt_pmic_vusb33_ldo_reg = "/mt-pmic/ldo_regulators/ldo_vusb33";
        aw87329_pa = "/mt-pmic/ldo_regulators/aw87329_pa@";
        keypad = "/kp@10010000";
        mrdump_ext_rst = "/mrdump_ext_rst";
        touch = "/touch";
        accdet = "/accdet";
        bat_gm30 = "/battery";
        iommu = "/m4u@10205000";
        mdcldma = "/mdcldma@10014000";
        gce = "/gce@10238000";
        gce_mbox = "/gce_mbox@10238000";
        auxadc = "/auxadc@11001000";
        apdma = "/dma-controller@11000580";
        uart0 = "/serial@11020000";
        uart1 = "/serial@11030000";
        pwm = "/pwm@11006000";
        i2c_common = "/i2c_common";
        i2c0 = "/i2c0@11007000";
        i2c1 = "/i2c1@11008000";
        i2c2 = "/i2c2@11009000";
        i2c3 = "/i2c3@1100f000";
        i2c4 = "/i2c4@11011000";
        i2c5 = "/i2c5@11016000";
        i2c6 = "/i2c6@1100d000";
        i2c7 = "/i2c7";
        i2c8 = "/i2c8";
        i2c9 = "/i2c9";
        spi0 = "/spi0@1100a000";
        consys = "/consys@18002000";
        spi1 = "/spi1@11010000";
        spi2 = "/spi2@11012000";
        spi3 = "/spi3@11013000";
        spi4 = "/spi4@11014000";
        spi5 = "/spi5@11015000";
        msdc0 = "/msdc@11230000";
        msdc1 = "/msdc@11240000";
        msdc2 = "/msdc@11250000";
        msdc3 = "/msdc@11260000";
        msdc1_ins = "/msdc1_ins@0";
        audio = "/audio@11220000";
        audgpio = "/mt_soc_dl1_pcm@11220000";
        mipi_rx_ana_csi0a = "/mipi_rx_ana_csi0a@11c10000";
        mipi_rx_ana_csi0b = "/mipi_rx_ana_csi0b@11c11000";
        mipi_rx_ana_csi1a = "/mipi_rx_ana_csi1a@11c12000";
        mipi_rx_ana_csi1b = "/mipi_rx_ana_csi1b@11c13000";
        mipi_rx_ana_csi2a = "/mipi_rx_ana_csi2a@11c14000";
        mipi_rx_ana_csi2b = "/mipi_rx_ana_csi2b@11c15000";
        mfg_cfg = "/mfg_cfg@13ffe000";
        mmsys_config = "/mmsys_config@14000000";
        nfc = "/nfc";
        irq_nfc = "/irq_nfc";
        disp_mutex0 = "/disp_mutex0@14001000";
        smi_larb0 = "/smi_larb0@14003000";
        mdp_rdma0 = "/mdp_rdma0@14004000";
        mdp_ccorr = "/mdp_ccorr0@14005000";
        mdp_rsz0 = "/mdp_rsz0@14006000";
        mdp_rsz1 = "/mdp_rsz1@14007000";
        mdp_wdma0 = "/mdp_wdma0@14008000";
        mdp_wrot0 = "/mdp_wrot0@14009000";
        mdp_tdshp0 = "/mdp_tdshp0@1400a000";
        disp_color0 = "/disp_color0@1400f000";
        mtkfb = "/mtkfb@0";
        dsi_te = "/dsi_te";
        mm_mutex = "/mm_mutex@14016000";
        camsys = "/camsys@15000000";
        smi_larb2 = "/smi_larb2@15001000";
        kd_camera_hw1 = "/kd_camera_hw1@15040000";
        flashlight_core = "/flashlight_core";
        flashlights_mt6370 = "/flashlights_mt6370";
        venc_gcon = "/venc_gcon@17000000";
        smi_larb1 = "/smi_larb1@17010000";
        otg_iddig = "/otg_iddig";
        odm = "/odm";
        radio_md_cfg = "/radio_md_cfg";
        dynamic_options = "/dynamic_options";
        mt_charger = "/mt_charger";
        lk_charger = "/lk_charger";
        charger = "/charger";
        rt9465_slave_chr = "/rt9465_slave_chr";
        subpmic_pmu_eint = "/mt6370_pmu_eint";
        pmic_clock_buffer_ctrl = "/pmic_clock_buffer_ctrl";
        mt6370_pmu = "/mt6370_pmu_dts";
        mt6370_typec = "/type_c_port0";
    };
};